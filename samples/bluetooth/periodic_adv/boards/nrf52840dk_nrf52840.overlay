/*
 * Copyright (c) 2020 Nordic Semiconductor ASA
 *
 * SPDX-License-Identifier: Apache-2.0
 */

&spi0 {
	compatible = "nordic,nrf-spim";
	status = "okay";

	mosi-pin = <3>;
	miso-pin = <8>;
	cs-gpios = <&gpio0 28 GPIO_ACTIVE_LOW>;
	sck-pin = <29>;

	miso-pull-up;

	bt-hci@0 {
		compatible = "zephyr,bt-hci-spi";
		reg = <0>;
		irq-gpios = <&gpio0 30 (GPIO_ACTIVE_HIGH | GPIO_PULL_DOWN)>;
		reset-gpios = <&gpio0 31 (GPIO_ACTIVE_LOW | GPIO_PULL_UP)>;
		spi-max-frequency = <2000000>;
		label = "NRF53";
	};
};

&i2c0 {
	status = "disabled";
};
