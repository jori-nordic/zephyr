## boards/nordic/nrf52dk/nrf52dk_nrf52805_defconfig
```kconfig
# SPDX-License-Identifier: Apache-2.0

# Enable MPU
CONFIG_ARM_MPU=y

# Enable hardware stack protection
CONFIG_HW_STACK_PROTECTION=y

# Enable GPIO
CONFIG_GPIO=y

# Enable UART driver
# CONFIG_SERIAL=y

# Enable console
CONFIG_CONSOLE=y
# CONFIG_UART_CONSOLE=y

# Bluetooth not enabled by default on nRF52805 due to RAM limitations when
# running the default set of kernel tests.

CONFIG_GPIO_AS_PINRESET=n
CONFIG_CLOCK_CONTROL_NRF_K32SRC_RC=y

# Yeeeet overboard
CONFIG_BT_GATT_SERVICE_CHANGED=n
CONFIG_BT_GATT_CACHING=n
CONFIG_BT_GATT_ENFORCE_SUBSCRIPTION=n
CONFIG_BT_GATT_READ_MULTIPLE=n
CONFIG_BT_GATT_READ_MULT_VAR_LEN=n
CONFIG_BT_GAP_AUTO_UPDATE_CONN_PARAMS=n
CONFIG_BT_AUTO_PHY_UPDATE=n
CONFIG_BT_AUTO_DATA_LEN_UPDATE=n
```

## drivers/serial/Kconfig.posix_pipe
```kconfig
# Copyright (c) 2024 Nordic Semiconductor ASA
# SPDX-License-Identifier: Apache-2.0
#
config UART_POSIX_PIPE
	bool "UART driver for interacting named POSIX pipes"
	default y
	depends on DT_HAS_ZEPHYR_POSIX_PIPE_UART_ENABLED
	select TIMER if UART_ASYNC_API
	select SERIAL_HAS_DRIVER
	select SERIAL_SUPPORT_ASYNC
	select SERIAL_SUPPORT_INTERRUPT
```

## tests/bluetooth/host/id/bt_id_create/Kconfig
```kconfig
config SELECT_BT_HCI_SET_PUBLIC_ADDR
	bool "dummy kconfig"
	select BT_HCI_SET_PUBLIC_ADDR
	help
	  dummy kconfig

source "Kconfig.zephyr"
```
