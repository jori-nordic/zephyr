## prj.conf
```kconfig
CONFIG_BT=y
CONFIG_BT_DEVICE_NAME="GATT tester"
CONFIG_BT_PERIPHERAL=y
CONFIG_BT_CENTRAL=y

CONFIG_BT_SMP=y

CONFIG_ASSERT=y
CONFIG_BT_TESTING=y
CONFIG_BT_DEBUG_LOG=y

CONFIG_BT_ID_MAX=3
CONFIG_BT_MAX_PAIRED=3
CONFIG_BT_MAX_CONN=3
CONFIG_BT_EXT_ADV=y

CONFIG_BT_PRIVACY=y

CONFIG_BT_DEBUG_ID=y

CONFIG_BT_EXT_ADV_LEGACY_SUPPORT=y
# CONFIG_BT_REMOTE_INFO=y
# CONFIG_BT_REMOTE_VERSION=y
```

## src/common.h
```c
/**
 * Common functions and helpers for BSIM GATT tests
 *
 * Copyright (c) 2022 Nordic Semiconductor ASA
 *
 * SPDX-License-Identifier: Apache-2.0
 */

#include <zephyr/kernel.h>

#include "bs_types.h"
#include "bs_tracing.h"
#include "time_machine.h"
#include "bstests.h"
#include "zephyr/sys/__assert.h"

#include <zephyr/types.h>
#include <stddef.h>
#include <errno.h>
#include <stdint.h>

#include <zephyr/bluetooth/bluetooth.h>
#include <zephyr/bluetooth/hci.h>
#include <zephyr/bluetooth/conn.h>
#include <zephyr/bluetooth/uuid.h>
#include <zephyr/bluetooth/gatt.h>

extern enum bst_result_t bst_result;

#define WAIT_TIME (60 * 1e6) /*seconds*/

#define CREATE_FLAG(flag) static atomic_t flag = (atomic_t)false
#define SET_FLAG(flag) (void)atomic_set(&flag, (atomic_t)true)
#define UNSET_FLAG(flag) (void)atomic_set(&flag, (atomic_t)false)
#define WAIT_FOR_FLAG(flag)                                                                        \
	printk("WAIT_SET( " #flag " )\n"); \
	while (!(bool)atomic_get(&flag)) {                                                         \
		(void)k_sleep(K_MSEC(1));                                                          \
	}\
	printk("FLAG_SET( " #flag " )\n");
#define WAIT_FOR_FLAG_UNSET(flag)	  \
	printk("WAIT_UNSET( " #flag " )\n"); \
	while ((bool)atomic_get(&flag)) { \
		(void)k_sleep(K_MSEC(1)); \
	}\
	printk("FLAG_UNSET( " #flag " )\n");

#define ASSERT(expr, ...) if (! (expr)) {FAIL(__VA_ARGS__);}

#define FAIL(...)                                                                                  \
	do {                                                                                       \
		bst_result = Failed;                                                               \
		bs_trace_error_time_line(__VA_ARGS__);                                             \
	} while (0)

#define PASS(...)                                                                                  \
	do {                                                                                       \
		bst_result = Passed;                                                               \
		bs_trace_info_time(1, __VA_ARGS__);                                                \
	} while (0)

void test_tick(bs_time_t HW_device_time);
void test_init(void);

static inline bt_addr_le_t peripheral_id_a() {
	bt_addr_le_t addr;
	int err = bt_addr_le_from_str("FC:AF:B0:2F:D2:A8", "random", &addr);
	__ASSERT_NO_MSG(!err);
	return addr;
}

static inline bt_addr_le_t peripheral_id_b() {
	bt_addr_le_t addr;
	int err = bt_addr_le_from_str("FC:75:B3:90:E6:D9", "random", &addr);
	__ASSERT_NO_MSG(!err);
	return addr;
}

static inline bt_addr_le_t central_id() {
	bt_addr_le_t addr;
	int err = bt_addr_le_from_str("FF:98:69:6B:E4:D5", "random", &addr);
	__ASSERT_NO_MSG(!err);
	return addr;
}
```

## src/gatt_client_test.c
```c
/*
 * Copyright (c) 2022 Nordic Semiconductor ASA
 *
 * SPDX-License-Identifier: Apache-2.0
 */

#include <zephyr/bluetooth/bluetooth.h>

#include "common.h"
#include "zephyr/bluetooth/addr.h"
#include "zephyr/bluetooth/conn.h"
#include <stdint.h>

CREATE_FLAG(flag_is_connected);
CREATE_FLAG(flag_is_bonded);

static struct bt_conn *g_conn;

static void connected(struct bt_conn *conn, uint8_t err)
{
	char addr[BT_ADDR_LE_STR_LEN];

	bt_addr_le_to_str(bt_conn_get_dst(conn), addr, sizeof(addr));

	if (err != 0) {
		FAIL("Failed to connect to %s (%u)\n", addr, err);
		return;
	}

	printk("connected, conn %d, dst %s\n", bt_conn_index(conn), addr);

	if (g_conn == NULL) {
		g_conn = bt_conn_ref(conn);
	}

	if (conn == g_conn) {
		SET_FLAG(flag_is_connected);
	}
}

static void disconnected(struct bt_conn *conn, uint8_t reason)
{
	char addr[BT_ADDR_LE_STR_LEN];
	bt_addr_le_to_str(bt_conn_get_dst(conn), addr, sizeof(addr));
	printk("disconnected, conn %d, dst %s, reason 0x%02x\n", bt_conn_index(conn), addr, reason);

	if (conn != g_conn) {
		return;
	}

	bt_conn_unref(g_conn);
	g_conn = NULL;

	UNSET_FLAG(flag_is_connected);
	UNSET_FLAG(flag_is_bonded);
}

static void pairing_failed(struct bt_conn *conn, enum bt_security_err reason)
{
	FAIL("pairing_failed, conn %d, bt_security_err %d)\n", bt_conn_index(conn), reason);
}

static void pairing_complete(struct bt_conn *conn, bool bonded)
{
	char addr_str[BT_ADDR_LE_STR_LEN];
	bt_addr_le_to_str(bt_conn_get_dst(g_conn), addr_str, sizeof(addr_str));
	printk("pairing_complete, conn %d, dst %s, bonded %d\n", bt_conn_index(conn), addr_str, bonded);

	SET_FLAG(flag_is_bonded);
}

static struct bt_conn_auth_info_cb bt_conn_auth_info_cb = {
	.pairing_failed = pairing_failed,
	.pairing_complete = pairing_complete,
};

static bt_addr_le_t expected_addr;

void device_found(const bt_addr_le_t *addr, int8_t rssi, uint8_t type, struct net_buf_simple *ad)
{
	char addr_str[BT_ADDR_LE_STR_LEN];
	int err;

	if (g_conn != NULL) {
		return;
	}

	/* We're only interested in connectable events */
	if (type != BT_HCI_ADV_IND && type != BT_HCI_ADV_DIRECT_IND) {
		FAIL("Unexpected advertisement type.");
	}

	bt_addr_le_to_str(addr, addr_str, sizeof(addr_str));
	printk("device_found, dst %s, RSSI %d\n", addr_str, rssi);

	if (bt_addr_le_cmp(&expected_addr, BT_ADDR_LE_ANY) != 0) {
		if (bt_addr_le_cmp(addr, &expected_addr) != 0) {
			char expected_addr_str[BT_ADDR_LE_STR_LEN];
			bt_addr_le_to_str(&expected_addr, expected_addr_str, sizeof(expected_addr_str));
			printk("Ignoring. Looking for %s.\n", expected_addr_str);
			return;
		}
	}

	err = bt_le_scan_stop();
	if (err != 0) {
		FAIL("Could not stop scan: %d");
		return;
	}

	err = bt_conn_le_create(addr, BT_CONN_LE_CREATE_CONN, BT_LE_CONN_PARAM_DEFAULT, &g_conn);
	if (err != 0) {
		FAIL("Could not connect to peer: %d", err);
	}
}

static void setup(void)
{
	int id;
	bt_addr_le_t addr;

	addr = central_id();
	uint8_t irk[18];
	memset(irk, 123, sizeof(irk));
	id = bt_id_create(&addr, irk);
	if (id < 0) {
		FAIL("bt_id_create id_b failed (err %d)\n", id);
		return;
	}
	printk("bt_id_create: %d\n", id);

	int err;
	err = bt_enable(NULL);
	if (err != 0) {
		FAIL("Bluetooth discover failed (err %d)\n", err);
	}

	bt_conn_auth_info_cb_register(&bt_conn_auth_info_cb);

	BUILD_ASSERT(CONFIG_BT_MAX_PAIRED >= 2, "CONFIG_BT_MAX_PAIRED is too small.");

	/* Connect and bond with remote id a  */
	printk("\n");
	printk("sync 1: Bonding id a\n");
	expected_addr = BT_ADDR_LE_ANY[0];
	err = bt_le_scan_start(BT_LE_SCAN_PASSIVE, device_found);
	if (err != 0) {
		FAIL("Scanning failed to start (err %d)\n", err);
	}
	printk("bt_le_scan_start ok\n");

	WAIT_FOR_FLAG(flag_is_connected);

	err = bt_conn_set_security(g_conn, BT_SECURITY_L2);
	if (err) {
		FAIL("Starting encryption procedure failed (%d)\n", err);
	}

	WAIT_FOR_FLAG(flag_is_bonded);

	err = bt_conn_disconnect(g_conn, BT_HCI_ERR_REMOTE_USER_TERM_CONN);
	if (err) {
		FAIL("Disconnect failed (%d)\n", err);
	}
	printk("bt_conn_disconnect ok\n");

	WAIT_FOR_FLAG_UNSET(flag_is_connected);


	/* Connect and bond with remote id b  */
	printk("\n");
	printk("sync 2: Bonding id b\n");
	expected_addr = BT_ADDR_LE_ANY[0];
	err = bt_le_scan_start(BT_LE_SCAN_PASSIVE, device_found);
	if (err != 0) {
		FAIL("Scanning failed to start (err %d)\n", err);
	}
	printk("bt_le_scan_start ok\n");

	WAIT_FOR_FLAG(flag_is_connected);

	err = bt_conn_set_security(g_conn, BT_SECURITY_L2);
	if (err) {
		FAIL("Starting encryption procedure failed (%d)\n", err);
	}

	WAIT_FOR_FLAG(flag_is_bonded);

	err = bt_conn_disconnect(g_conn, BT_HCI_ERR_REMOTE_USER_TERM_CONN);
	if (err) {
		FAIL("Disconnect failed (%d)\n", err);
	}
	printk("bt_conn_disconnect ok\n");

	WAIT_FOR_FLAG_UNSET(flag_is_connected);


	/* Connect to directed advertisement  */
	expected_addr = peripheral_id_b();
	err = bt_le_scan_start(BT_LE_SCAN_PASSIVE, device_found);
	if (err != 0) {
		FAIL("Scanning failed to start (err %d)\n", err);
	}

	printk("Scanning successfully started\n");
	WAIT_FOR_FLAG(flag_is_connected);

}

static struct bt_conn_cb conn_callbacks = {
	.connected = connected,
	.disconnected = disconnected,
};

static void test_main_none(void)
{
	bt_conn_cb_register(&conn_callbacks);
	setup();
	PASS("");
}

static const struct bst_test_instance test_vcs[] = {
	{
		.test_id = "gatt_client_none",
		.test_post_init_f = test_init,
		.test_tick_f = test_tick,
		.test_main_f = test_main_none,
	},
	BSTEST_END_MARKER,
};

struct bst_test_list *test_gatt_client_install(struct bst_test_list *tests)
{
	return bst_add_tests(tests, test_vcs);
}
```

## src/gatt_server_test.c
```c
/*
 * Copyright (c) 2022 Nordic Semiconductor ASA
 *
 * SPDX-License-Identifier: Apache-2.0
 */

#include "common.h"
#include "zephyr/bluetooth/bluetooth.h"
#include "zephyr/bluetooth/addr.h"
#include "zephyr/toolchain/gcc.h"
#include <stdint.h>
#include <string.h>

extern enum bst_result_t bst_result;

CREATE_FLAG(flag_is_connected);

static struct bt_conn *g_conn;


static void connected(struct bt_conn *conn, uint8_t err)
{
	char addr[BT_ADDR_LE_STR_LEN];

	bt_addr_le_to_str(bt_conn_get_dst(conn), addr, sizeof(addr));

	if (err != 0) {
		FAIL("Failed to connect to %s (%u)\n", addr, err);
		return;
	}

	printk("connected, conn %d, dst %s\n", bt_conn_index(conn), addr);

	if (g_conn == NULL) {
		g_conn = bt_conn_ref(conn);
	}

	if (conn == g_conn) {
		SET_FLAG(flag_is_connected);
	}
}

static void disconnected(struct bt_conn *conn, uint8_t reason)
{
	char addr[BT_ADDR_LE_STR_LEN];
	bt_addr_le_to_str(bt_conn_get_dst(conn), addr, sizeof(addr));
	printk("disconnected, conn %d, dst %s, reason 0x%02x\n", bt_conn_index(conn), addr, reason);

	if (conn != g_conn) {
		return;
	}

	bt_conn_unref(g_conn);
	g_conn = NULL;

	UNSET_FLAG(flag_is_connected);
}

static void pairing_failed(struct bt_conn *conn, enum bt_security_err reason)
{
	FAIL("pairing_failed, conn %d, bt_security_err %d)\n", bt_conn_index(conn), reason);
}

static void pairing_complete(struct bt_conn *conn, bool bonded)
{
	char addr_str[BT_ADDR_LE_STR_LEN];
	bt_addr_le_to_str(bt_conn_get_dst(g_conn), addr_str, sizeof(addr_str));
	printk("pairing_complete, conn %d, dst %s, bonded %d\n", bt_conn_index(conn), addr_str, bonded);
}

static struct bt_conn_auth_info_cb bt_conn_auth_info_cb = {
	.pairing_failed = pairing_failed,
	.pairing_complete = pairing_complete,
};

static void format_id_addr(int id, char addr_str[BT_ADDR_LE_STR_LEN])
{
	bt_addr_le_t addrs[CONFIG_BT_ID_MAX];
	size_t count = CONFIG_BT_ID_MAX;

	bt_id_get(addrs, &count);
	ASSERT(count > id, "");

	bt_addr_le_to_str(&addrs[id], addr_str, BT_ADDR_LE_STR_LEN);
}

static void adv_on_id(int id, struct bt_le_adv_param *param)
{
	memset(param, 0, sizeof(*param));
	param->id = id;

	param->interval_min = 0x0020;
	param->interval_max = 0x4000;
	param->options |= BT_LE_ADV_OPT_USE_NAME;
	param->options |= BT_LE_ADV_OPT_ONE_TIME;
	param->options |= BT_LE_ADV_OPT_CONNECTABLE;
	int err = bt_le_adv_start(param, NULL, 0, NULL, 0);
	ASSERT(err == 0, "Advertising failed to start (err %d)\n", err);

	char addr_str[BT_ADDR_LE_STR_LEN];
	format_id_addr(id, addr_str);
	printk("Advertising started on ID %d - %s\n", id, addr_str);
}

static void setup(void)
{
	int err;
	bt_addr_le_t central;
	bt_addr_le_t addr;
	int id_a;
	int id_b;
	struct bt_le_adv_param adv_param1;
	struct bt_le_adv_param adv_param2;
	struct bt_le_adv_param adv_param3;

	err = bt_enable(NULL);
	if (err != 0) {
		FAIL("Bluetooth init failed (err %d)\n", err);
		return;
	}

	bt_conn_auth_info_cb_register(&bt_conn_auth_info_cb);

	BUILD_ASSERT(CONFIG_BT_MAX_PAIRED >= 2, "CONFIG_BT_MAX_PAIRED is too small.");
	BUILD_ASSERT(CONFIG_BT_ID_MAX >= 3, "CONFIG_BT_ID_MAX is too small.");

	/* Create and bond id a  */
	printk("sync 1: Bonding id a\n");
	addr = peripheral_id_a();
	id_a = bt_id_create(&addr, NULL);
	ASSERT(id_a >= 0, "bt_id_create id_a failed (err %d)\n", id_a);
	printk("bt_id_create id_a: %d\n", id_a);

	adv_on_id(id_a, &adv_param1);
	WAIT_FOR_FLAG(flag_is_connected);
	/* Central should bond here, and trigger a disconnect. */
	WAIT_FOR_FLAG_UNSET(flag_is_connected);

	/* Create and bond id b  */
	printk("sync 2: Bonding id b\n");
	addr = peripheral_id_b();
	id_b = bt_id_create(&addr, NULL);
	ASSERT(id_b >= 0, "bt_id_create id_b failed (err %d)\n", id_b);
	printk("bt_id_create: %d\n", id_b);

	adv_on_id(id_b, &adv_param2);
	WAIT_FOR_FLAG(flag_is_connected);
	central = *bt_conn_get_dst(g_conn);
	/* Central should bond here. */
	WAIT_FOR_FLAG_UNSET(flag_is_connected);

	/* bt_id_delete(id_a); */

	/* Directed advertisement connect  */
	adv_param3 = (struct bt_le_adv_param){};
	adv_param3.interval_min = 0x0020;
	adv_param3.interval_max = 0x4000;
	adv_param3.options |= BT_LE_ADV_OPT_USE_NAME;
	adv_param3.options |= BT_LE_ADV_OPT_ONE_TIME;
	adv_param3.options |= BT_LE_ADV_OPT_CONNECTABLE;
	adv_param3.id = id_b;
	adv_param3.options |= BT_LE_ADV_OPT_DIR_ADDR_RPA;
	adv_param3.peer = &central;
	err = bt_le_adv_start(&adv_param3, NULL, 0, NULL, 0);
	if (err != 0) {
		FAIL("Advertising failed to start (err %d)\n", err);
		return;
	}

	WAIT_FOR_FLAG(flag_is_connected);
	/* Central should verify that its bond with id_b works as expected. */
}

static struct bt_conn_cb conn_callbacks = {
	.connected = connected,
	.disconnected = disconnected,
};


static void test_main_none(void)
{
	bt_conn_cb_register(&conn_callbacks);
	setup();
	PASS("");
}

static const struct bst_test_instance test_gatt_server[] = {
	{
		.test_id = "gatt_server_none",
		.test_post_init_f = test_init,
		.test_tick_f = test_tick,
		.test_main_f = test_main_none,
	},
	BSTEST_END_MARKER,
};

struct bst_test_list *test_gatt_server_install(struct bst_test_list *tests)
{
	return bst_add_tests(tests, test_gatt_server);
}
```
