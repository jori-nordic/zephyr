## CMakeLists.txt
```
# SPDX-License-Identifier: Apache-2.0

cmake_minimum_required(VERSION 3.20.0)

if (NOT DEFINED ENV{BSIM_COMPONENTS_PATH})
	message(FATAL_ERROR "This test requires the BabbleSim simulator. Please set\
 the  environment variable BSIM_COMPONENTS_PATH to point to its components \
 folder. More information can be found in\
 https://babblesim.github.io/folder_structure_and_env.html")
endif()

find_package(Zephyr HINTS $ENV{ZEPHYR_BASE})
project(bsim_test_gatt_settings)

target_sources(app PRIVATE
	src/server.c
	src/client.c
	src/utils.c
	src/gatt_utils.c
	src/main.c
)

zephyr_include_directories(
  $ENV{BSIM_COMPONENTS_PATH}/libUtilv1/src/
  $ENV{BSIM_COMPONENTS_PATH}/libPhyComv1/src/
  )
```

## prj.conf
```kconfig
CONFIG_BT=y
CONFIG_BT_PERIPHERAL=y
CONFIG_BT_CENTRAL=y
CONFIG_BT_DEVICE_NAME="GATT settings"

CONFIG_ASSERT=y
CONFIG_BT_TESTING=y
CONFIG_BT_DEBUG_LOG=y
# CONFIG_BT_DEBUG_GATT=y

CONFIG_BT_AUTO_PHY_UPDATE=n
CONFIG_BT_AUTO_DATA_LEN_UPDATE=n
CONFIG_BT_GAP_AUTO_UPDATE_CONN_PARAMS=n

CONFIG_BT_SMP=y
CONFIG_BT_GATT_CLIENT=y
CONFIG_BT_GATT_DYNAMIC_DB=y
CONFIG_BT_GATT_CACHING=y

CONFIG_SETTINGS=y
CONFIG_SETTINGS_CUSTOM=y
CONFIG_BT_SETTINGS=y

CONFIG_BT_DEBUG_GATT=y
```

## src/main.c
```c
/*
 * Copyright (c) 2023 Nordic Semiconductor ASA
 *
 * SPDX-License-Identifier: Apache-2.0
 */

#include "utils.h"
#include "main.h"
#include "argparse.h"
#include "bs_pc_backchannel.h"
#include "bstests.h"

#include <zephyr/sys/__assert.h>

void server_procedure(void);
void client_procedure(void);

#define BS_SECONDS(dur_sec)    ((bs_time_t)dur_sec * USEC_PER_SEC)
#define TEST_TIMEOUT_SIMULATED BS_SECONDS(60)

static int test_round;
static int final_round;
static char *settings_file;

int get_test_round(void)
{
	return test_round;
}

bool is_final_round(void)
{
	return test_round == final_round;
}

char *get_settings_file(void)
{
	return settings_file;
}

static void test_args(int argc, char **argv)
{
	__ASSERT(argc == 3, "Please specify only 3 test arguments\n");

	test_round = atol(argv[0]);
	final_round = atol(argv[1]);
	settings_file = argv[2];

	bs_trace_raw(0, "Test round %u\n", test_round);
	bs_trace_raw(0, "Final round %u\n", final_round);
}

void test_tick(bs_time_t HW_device_time)
{
	bs_trace_debug_time(0, "Simulation ends now.\n");
	if (bst_result != Passed) {
		bst_result = Failed;
		bs_trace_error("Test did not pass before simulation ended.\n");
	}
}

void test_init(void)
{
	bst_ticker_set_next_tick_absolute(TEST_TIMEOUT_SIMULATED);
	bst_result = In_progress;
}

static const struct bst_test_instance test_to_add[] = {
	{
		.test_id = "server",
		.test_pre_init_f = test_init,
		.test_tick_f = test_tick,
		.test_main_f = server_procedure,
		.test_args_f = test_args,
	},
	{
		.test_id = "client",
		.test_pre_init_f = test_init,
		.test_tick_f = test_tick,
		.test_main_f = client_procedure,
		.test_args_f = test_args,
	},
	BSTEST_END_MARKER,
};

static struct bst_test_list *install(struct bst_test_list *tests)
{
	return bst_add_tests(tests, test_to_add);
};

bst_test_install_t test_installers[] = { install, NULL };

void main(void)
{
	bst_main();
}


void backchannel_init(void)
{
	uint device_number = get_device_nbr();
	uint channel_numbers[2] = { 0, 0, };
	uint device_numbers[2];
	uint num_ch;
	uint *ch;

	/* No backchannels to next/prev device if only device */
	if (get_test_round() == 0 && is_final_round()) {
		return;
	}

	/* Each `server` round/instance gets a connection to the previous and to
	 * the next instance in the chain. It waits until it is signalled by the
	 * previous instance, then runs its test procedure and finally signals
	 * the next instance in the chain.
	 *
	 * The two ends of the chain get only one channel, hence the difference
	 * in handling.
	 */

	if (get_test_round() == 0) {
		/* send only */
		device_numbers[0] = get_device_nbr() + 1;
		num_ch = 1;

	} else if (is_final_round()) {
		/* receive only */
		device_numbers[0] = get_device_nbr() - 1;
		num_ch = 1;

	} else {
		/* send signal */
		device_numbers[0] = get_device_nbr() + 1;
		/* receive signal */
		device_numbers[1] = get_device_nbr() - 1;
		num_ch = 2;
	}

	printk("Opening backchannels\n");
	ch = bs_open_back_channel(device_number, device_numbers,
				  channel_numbers, num_ch);
	if (!ch) {
		FAIL("Unable to open backchannel\n");
	}
}

#define MSG_SIZE 1

void backchannel_sync_send(uint channel)
{
	uint8_t sync_msg[MSG_SIZE] = { get_device_nbr() };

	printk("Sending sync\n");
	bs_bc_send_msg(channel, sync_msg, ARRAY_SIZE(sync_msg));
}

void backchannel_sync_wait(uint channel)
{
	uint8_t sync_msg[MSG_SIZE];

	while (true) {
		if (bs_bc_is_msg_received(channel) > 0) {
			bs_bc_receive_msg(channel, sync_msg,
					  ARRAY_SIZE(sync_msg));
			if (sync_msg[0] != get_device_nbr()) {
				/* Received a message from another device, exit */
				break;
			}
		}

		k_sleep(K_MSEC(1));
	}

	printk("Sync received\n");
}

/* We can't really kill the device/process without borking the bsim
 * backchannels, so the next best thing is stopping all threads from processing,
 * thus stopping the Bluetooth host from processing the disconnect event (or any
 * event, really) coming from the link-layer.
 */
static void stop_all_threads(void)
{
	/* promote to highest priority */
	k_thread_priority_set(k_current_get(), K_HIGHEST_THREAD_PRIO);
	/* busy-wait loop */
	for (;;) {
		k_busy_wait(1000);
		k_yield();
	}
}

void signal_next_test_round(void)
{
	if (!is_final_round()) {
		backchannel_sync_send(0);
	}

	PASS("round %d over\n", get_test_round());
	stop_all_threads();
}

void wait_for_round_start(void)
{
	backchannel_init();

	if (is_final_round()) {
		backchannel_sync_wait(0);
	} else if (get_test_round() != 0) {
		backchannel_sync_wait(1);
	}
}
```

## src/client.c
```c
/*
 * Copyright (c) 2023 Nordic Semiconductor ASA
 *
 * SPDX-License-Identifier: Apache-2.0
 */

#include "utils.h"
#include "zephyr/bluetooth/addr.h"
#include "zephyr/bluetooth/bluetooth.h"
#include "zephyr/bluetooth/conn.h"
#include <zephyr/settings/settings.h>

#include <stdint.h>
#include <string.h>

void client_round_0(void)
{
	struct bt_conn *conn;

	printk("start round 0...........\n");

	conn = connect_as_peripheral();
	printk("connected: conn %p\n", conn);
	wait_secured();

	gatt_discover();
	activate_robust_caching();
	read_test_char(false);

	disconnect(conn);
}

void client_round_1(void)
{
	struct bt_conn *conn;

	printk("start round 1...........\n");

	conn = connect_as_peripheral();
	printk("connected: conn %p\n", conn);
	wait_secured();

	read_test_char(false);

	disconnect(conn);
}

void client_round_2(void)
{
	struct bt_conn *conn;

	printk("start round 2...........\n");

	conn = connect_as_peripheral();
	printk("connected: conn %p\n", conn);
	wait_secured();

	/* GATT DB has changed */
	read_test_char(false);

	disconnect(conn);
}

void client_procedure(void)
{
	bt_enable(NULL);
	settings_load();

	k_msleep(1000);

	client_round_0();
	client_round_1();
	client_round_2();

	PASS("PASS\n");
}
/* Procedures:
 *
 * 1.
 *   - boot
 *   - register service
 *   - connect
 *   - bond
 *   - mark robust caching
 *   - gatt read
 *   - powercycle server
 *
 * 2.
 *   - boot
 *   - register service
 *   - connect
 *   - encrypt
 *   - gatt read (ok)
 *   - disconnect
 *   - powercycle
 *
 * 3.
 *   - boot
 *   - connect
 *   - encrypt
 *   - gatt read (fail)
 *   - CU -> CA (hash read?)
 *   - gatt read (ok)
 *   - powercycle
 *
 * 4.
 *   - boot
 *   - connect
 *   - encrypt
 *   - gatt read (ok)
 *
 */
```

## src/gatt_utils.c
```c
#include "utils.h"
#include "argparse.h"
#include "bs_pc_backchannel.h"

#include <zephyr/kernel.h>
#include <zephyr/bluetooth/bluetooth.h>
#include <zephyr/bluetooth/gatt.h>

/* Custom Service Variables */
static struct bt_uuid_128 test_uuid = BT_UUID_INIT_128(
	0xf0, 0xde, 0xbc, 0x9a, 0x78, 0x56, 0x34, 0x12,
	0x78, 0x56, 0x34, 0x12, 0x78, 0x56, 0x34, 0x12);
static struct bt_uuid_128 test_uuid_2 = BT_UUID_INIT_128(
	0xf1, 0xdd, 0xbc, 0x9a, 0x78, 0x56, 0x34, 0x12,
	0x78, 0x56, 0x34, 0x12, 0x78, 0x56, 0x34, 0x12);
static struct bt_uuid_128 test_chrc_uuid = BT_UUID_INIT_128(
	0xf2, 0xde, 0xbc, 0x9a, 0x78, 0x56, 0x34, 0x12,
	0x78, 0x56, 0x34, 0x12, 0x78, 0x56, 0x34, 0x12);

static uint8_t test_value[] = { 'T', 'e', 's', 't', '\0' };

static ssize_t read_test(struct bt_conn *conn, const struct bt_gatt_attr *attr,
			void *buf, uint16_t len, uint16_t offset)
{
	printk("Client has read from test char\n");
	const char *value = attr->user_data;

	return bt_gatt_attr_read(conn, attr, buf, len, offset, value,
				 strlen(value));
}

static ssize_t write_test(struct bt_conn *conn, const struct bt_gatt_attr *attr,
			 const void *buf, uint16_t len, uint16_t offset,
			 uint8_t flags)
{
	printk("Client has written to test char\n");
	uint8_t *value = attr->user_data;

	if (offset + len > sizeof(test_value)) {
		return BT_GATT_ERR(BT_ATT_ERR_INVALID_OFFSET);
	}

	memcpy(value + offset, buf, len);

	return len;
}

static struct bt_gatt_attr test_attrs[] = {
	/* Vendor Primary Service Declaration */
	BT_GATT_PRIMARY_SERVICE(&test_uuid),

	BT_GATT_CHARACTERISTIC(&test_chrc_uuid.uuid,
			       BT_GATT_CHRC_READ | BT_GATT_CHRC_WRITE,
			       BT_GATT_PERM_READ_ENCRYPT |
			       BT_GATT_PERM_WRITE_ENCRYPT,
			       read_test, write_test, test_value),
};

static struct bt_gatt_attr test_attrs_2[] = {
	/* Vendor Primary Service Declaration */
	BT_GATT_PRIMARY_SERVICE(&test_uuid_2),

	BT_GATT_CHARACTERISTIC(&test_chrc_uuid.uuid,
			       BT_GATT_CHRC_READ | BT_GATT_CHRC_WRITE,
			       BT_GATT_PERM_READ_ENCRYPT |
			       BT_GATT_PERM_WRITE_ENCRYPT,
			       read_test, write_test, test_value),
};

static struct bt_gatt_service test_svc = BT_GATT_SERVICE(test_attrs);
static struct bt_gatt_service test_svc_2 = BT_GATT_SERVICE(test_attrs_2);

void gatt_register_service(bool other)
{
	int err;

	if (other) {
		err = bt_gatt_service_register(&test_svc);
	} else {
		printk("................................. registering gatt\n");
		err = bt_gatt_service_register(&test_svc_2);
	}

	ASSERT(!err, "Failed to register GATT service (err %d)\n", err);
}

/* We need to discover:
 * - Dynamic service
 * - Client Features (to set robust caching)
 * - DB hash handle (to get out of the change-unaware state)
 */
enum GATT_HANDLES {
CLIENT_FEATURES,
DB_HASH,
TEST_CHAR,
NUM_HANDLES,
};

uint16_t gatt_handles[NUM_HANDLES] = {0};

DEFINE_FLAG(flag_discovered);

static uint8_t discover_func(struct bt_conn *conn, const struct bt_gatt_attr *attr,
			     struct bt_gatt_discover_params *params)
{
	int err;

	if (attr == NULL) {
		for (int i = 0; i < ARRAY_SIZE(gatt_handles); i++) {
			printk("handle[%d] = 0x%x\n", i, gatt_handles[i]);

			if (gatt_handles[i] == 0) {
				FAIL("Did not discover all characteristics\n");
			}
		}

		(void)memset(params, 0, sizeof(*params));

		SET_FLAG(flag_discovered);

		return BT_GATT_ITER_STOP;
	}

	if (params->type == BT_GATT_DISCOVER_PRIMARY &&
	    bt_uuid_cmp(params->uuid, &test_uuid.uuid) == 0) {
		printk("Found test service\n");
		params->uuid = NULL;
		params->start_handle = attr->handle + 1;
		params->type = BT_GATT_DISCOVER_CHARACTERISTIC;

		err = bt_gatt_discover(conn, params);
		if (err != 0) {
			FAIL("Discover failed (err %d)\n", err);
		}

		return BT_GATT_ITER_STOP;
	} else if (params->type == BT_GATT_DISCOVER_CHARACTERISTIC) {
		const struct bt_gatt_chrc *chrc = (struct bt_gatt_chrc *)attr->user_data;

		if (bt_uuid_cmp(chrc->uuid, BT_UUID_GATT_CLIENT_FEATURES) == 0) {
			printk("Found client supported features\n");
			gatt_handles[CLIENT_FEATURES] = chrc->value_handle;

		} else if (bt_uuid_cmp(chrc->uuid, BT_UUID_GATT_DB_HASH) == 0) {
			printk("Found db hash\n");
			gatt_handles[DB_HASH] = chrc->value_handle;

		} else 	if (bt_uuid_cmp(chrc->uuid, &test_chrc_uuid.uuid) == 0) {
			printk("Found test characteristic\n");
			gatt_handles[TEST_CHAR] = chrc->value_handle;
		}
	}

	return BT_GATT_ITER_CONTINUE;
}

void gatt_discover(void)
{
	static struct bt_gatt_discover_params discover_params;
	int err;

	printk("Discovering services and characteristics\n");
	UNSET_FLAG(flag_discovered);

	discover_params.uuid = NULL;
	discover_params.func = discover_func;
	discover_params.start_handle = BT_ATT_FIRST_ATTRIBUTE_HANDLE;
	discover_params.end_handle = BT_ATT_LAST_ATTRIBUTE_HANDLE;
	discover_params.type = BT_GATT_DISCOVER_CHARACTERISTIC;

	err = bt_gatt_discover(get_conn(), &discover_params);
	if (err != 0) {
		FAIL("Discover failed(err %d)\n", err);
	}

	WAIT_FOR_FLAG(flag_discovered);
	printk("Discover complete\n");
}

DEFINE_FLAG(flag_written);

static void write_cb(struct bt_conn *conn, uint8_t err, struct bt_gatt_write_params *params)
{
	if (err != BT_ATT_ERR_SUCCESS) {
		FAIL("Write failed: 0x%02X\n", err);
	}

	SET_FLAG(flag_written);
}

#define CF_BIT_ROBUST_CACHING 0
void activate_robust_caching(void)
{
	int err;

	static const uint8_t csf = BIT(CF_BIT_ROBUST_CACHING);
	static struct bt_gatt_write_params write_params = {
		.func = write_cb,
		.offset = 0,
		.data = &csf,
		.length = sizeof(csf),
	};

	write_params.handle = gatt_handles[CLIENT_FEATURES];

	UNSET_FLAG(flag_written);
	err = bt_gatt_write(get_conn(), &write_params);

	ASSERT(!err, "Failed to enable robust caching\n");

	WAIT_FOR_FLAG(flag_written);
	printk("Robust caching enabled\n");
}

DEFINE_FLAG(flag_read);

static uint8_t _expect_success(struct bt_conn *conn, uint8_t err,
			       struct bt_gatt_read_params *params,
			       const void *data, uint16_t length)
{
	/* printk("GATT read cb: err 0x%02X\n", err); */
	ASSERT(err == 0, "Failed to read: err 0x%x", err);

	SET_FLAG(flag_read);

	return 0;
}

static uint8_t _expect_out_of_sync_cb(struct bt_conn *conn, uint8_t err,
				     struct bt_gatt_read_params *params,
				     const void *data, uint16_t length)
{
	/* printk("GATT read cb: err 0x%02X\n", err); */
	ASSERT(err == BT_ATT_ERR_DB_OUT_OF_SYNC, "Didn't get expected error code: err 0x%x", err);

	SET_FLAG(flag_read);

	return 0;
}

void read_test_char(bool expect_err)
{
	int err;

	struct bt_gatt_read_params read_params = {
		.handle_count = 1,
		.single = {
			.handle = gatt_handles[TEST_CHAR],
			.offset = 0,
		},
	};

	if (expect_err) {
		read_params.func = _expect_out_of_sync_cb;
	} else {
		read_params.func = _expect_success;
	}

	UNSET_FLAG(flag_read);

	err = bt_gatt_read(get_conn(), &read_params);
	ASSERT(!err, "Failed to read char\n");

	WAIT_FOR_FLAG(flag_read);
}
```

## src/server.c
```c
/*
 * Copyright (c) 2023 Nordic Semiconductor ASA
 *
 * SPDX-License-Identifier: Apache-2.0
 */

#include "utils.h"
#include "main.h"
#include "gatt_utils.h"

#include <zephyr/bluetooth/addr.h>
#include <zephyr/bluetooth/bluetooth.h>
#include <zephyr/bluetooth/conn.h>
#include <zephyr/bluetooth/controller.h>
#include <zephyr/settings/settings.h>
#include <zephyr/toolchain/gcc.h>

#include <stdint.h>
#include <string.h>

void set_public_addr(void)
{
	/* bt_addr_le_t addr = {BT_ADDR_LE_RANDOM, */
	/* 		     {{0x0A, 0x89, 0x67, 0x45, 0x23, 0xC1}}}; */
	/* bt_id_create(&addr, NULL); */
	uint8_t addr[] = {0x0A, 0x89, 0x67, 0x45, 0x23, 0xC1};
	bt_ctlr_set_public_addr(addr);
}

void server_round_0(void)
{
	struct bt_conn *conn;

	/* Wait for GATT DB hash to complete.
	 *
	 * Only then, load the settings. This is done to trigger a bug where the
	 * hash was overwritten on NVS before the settings were loaded. It's a
	 * race condition between the loading of the settings and the hash being
	 * calculated and written to NVS.
	 */
	k_sleep(K_SECONDS(2));

	settings_load();

	conn = connect_as_central();
	wait_for_client_read();

	printk("bonding\n");
	bond(conn);
}

void server_round_1(void)
{
	struct bt_conn *conn;

	/* Wait for GATT DB hash to complete. */
	k_sleep(K_SECONDS(2));
	settings_load();

	conn = connect_as_central();
	printk("encrypting\n");
	set_security(conn, BT_SECURITY_L2);

	wait_for_client_read();
	wait_disconnected();

	printk("register second service, peer will be change-unaware\n");
	gatt_register_service_2();
	/* on-disk hash will be different when round 2 (and round 4)
	 * start, the peer will be marked as change-unaware
	 */
	k_sleep(K_MSEC(100));
}

void server_round_2(void)
{
	struct bt_conn *conn;

	/* Wait for GATT DB hash to complete. */
	k_sleep(K_SECONDS(2));
	settings_load();

	conn = connect_as_central();
	printk("encrypting\n");
	set_security(conn, BT_SECURITY_L2);

	wait_for_client_read();

	/* Kill the power before the graceful disconnect, to make sure
	 * that the change-aware status has been written correctly to
	 * NVS. We still have to wait for the delayed work to be run.
	 */
	k_sleep(K_MSEC(CONFIG_BT_SETTINGS_DELAYED_STORE_MS));
}

void server_round_3(void)
{
	struct bt_conn *conn;

	/* Wait for GATT DB hash to complete. */
	k_sleep(K_SECONDS(2));
	settings_load();

	conn = connect_as_central();
	printk("encrypting\n");
	set_security(conn, BT_SECURITY_L2);

	wait_for_client_read();
	wait_disconnected();

	printk("register second service, peer will be change-unaware\n");
	gatt_register_service_2();
	/* on-disk hash will be different when round 2 (and round 4)
	 * start, the peer will be marked as change-unaware
	 */
	k_sleep(K_MSEC(100));
}

void server_round_4(void)
{
	struct bt_conn *conn;

	/* Wait for GATT DB hash to complete. */
	k_sleep(K_SECONDS(2));
	settings_load();

	conn = connect_as_central();
	printk("encrypting\n");
	set_security(conn, BT_SECURITY_L2);

	wait_for_client_read();
	wait_disconnected();
}

void server_round_5(void)
{
	gatt_register_service_2();
	settings_load();

	/* sleep long enough to ensure the DB hash is stored to disk, but short
	 * enough to make sure the delayed storage work item is not executed.
	 */
	k_sleep(K_MSEC(100));
}

void server_round_6(void)
{
	struct bt_conn *conn;

	gatt_register_service_2();
	/* Wait for GATT DB hash to complete. */
	k_sleep(K_SECONDS(2));
	settings_load();

	conn = connect_as_central();
	printk("encrypting\n");
	set_security(conn, BT_SECURITY_L2);

	wait_for_client_read();
	wait_disconnected();
}

/* What is being tested: since this deals with settings it's not the rounds
 * themselves, but rather the transitions that test expected behavior.
 *
 * Round 0 -> 1: test CCC / CF values written before bonding are stored to NVS
 * if the server reboots before disconnecting.
 *
 * Round 1 -> 2: test change-awareness is updated if GATT DB changes _after_ the
 * peer has disconnected. In round 2 we also make sure we receive the Service
 * Changed indication.
 *
 * Round 2 -> 3: tests `CONFIG_BT_SETTINGS_CF_STORE_ON_WRITE` does its job, and
 * writes the change-awareness before we get disconnected. Basically, this
 * transition simulates a user yanking the power of the device before it has the
 * chance to disconnect.
 *
 * Round 3 -> 4: same as (1->2), except this time we won't get the SC indication
 * (as we have unsubscribed from it). We should instead get the
 * `BT_ATT_ERR_DB_OUT_OF_SYNC` error on the first attribute read. This also
 * tests that robust GATT caching is enforced.
 *
 * Round 4 -> 5: tests change-awareness status is still written on disconnect.
 * This is a non-regression test to make sure we didn't break the previous
 * behavior.
 *
 * Round 5 -> 6: tests DFU corner case: in this case, we are on the first boot
 * of an updated firmware, that will register new services. But for some unknown
 * reason, we decide to reboot before the delayed store work item has had the
 * time to execute and store that the peers are now change-unaware. Round 6 then
 * makes sure that we are indeed change-unaware.
 */
void server_procedure(void)
{
	uint8_t round = get_test_round();

	wait_for_round_start();

	printk("Start test round: %d\n", get_test_round());

	/* Use the same public address for all instances of the central. If we
	 * don't do that, encryption (using the bond stored in NVS) will
	 * fail.
	 */
	set_public_addr();

	bt_enable(NULL);
	gatt_register_service_1();

	switch (round) {
	case 0:
		server_round_0();
		break;
	case 1:
		server_round_1();
		break;
	case 2:
		server_round_2();
		break;
	case 3:
		server_round_3();
		break;
	case 4:
		server_round_4();
		break;
	case 5:
		server_round_5();
		break;
	case 6:
		server_round_6();
		break;
	default:
		FAIL("Round %d doesn't exist\n", round);
		break;
	}

	signal_next_test_round();
}
```

## src/settings.c
```c
/*
 * Copyright (c) 2023 Nordic Semiconductor
 *
 * SPDX-License-Identifier: Apache-2.0
 */

#include "utils.h"

#include <stdio.h>
#include <stddef.h>

#include <zephyr/kernel.h>
#include <zephyr/settings/settings.h>
#include "zephyr/types.h"
#include "errno.h"
#include "argparse.h"

#include <zephyr/logging/log.h>
LOG_MODULE_REGISTER(settings_backend, 3);

#define SETTINGS_FILE setting_file
#define SETTINGS_FILE_TMP setting_file_tmp

#define ENTRY_LEN_SIZE (4)
#define ENTRY_NAME_MAX_LEN (SETTINGS_MAX_NAME_LEN + SETTINGS_EXTRA_LEN)
#define ENTRY_VAL_MAX_LEN (SETTINGS_MAX_VAL_LEN * 2)
#define READ_LEN_MAX (ENTRY_VAL_MAX_LEN + ENTRY_NAME_MAX_LEN + 2)

struct line_read_ctx {
	int len;
	const uint8_t *val;
};

static char setting_file[50];
static char setting_file_tmp[sizeof(setting_file) + 1];

static int entry_check_and_copy(FILE *fin, FILE *fout, const char *name)
{
	char line[READ_LEN_MAX + 1];
	char name_tmp[strlen(name) + 2];

	snprintk(name_tmp, sizeof(name_tmp), "%s=", name);

	while (fgets(line, sizeof(line), fin) == line) {
		if (strstr(line, name_tmp) != NULL) {
			return 0;
		}

		if (fputs(line, fout) < 0) {
			return -1;
		}
	};

	return 0;
}

static ssize_t settings_line_read_cb(void *cb_arg, void *data, size_t len)
{
	struct line_read_ctx *valctx = (struct line_read_ctx *)cb_arg;

	if ((valctx->len / 2) > len) {
		return -ENOBUFS;
	}

	uint8_t *n = (uint8_t *) data;
	len = valctx->len / 2;

	for (int i = 0; i < len; i++, n++) {
		if (sscanf(&valctx->val[i * 2], "%2hhx", n) != 1) {
			return 0;
		};
	}

	return len;
}

static int settings_custom_load(struct settings_store *cs, const struct settings_load_arg *arg)
{
	FILE *fp = fopen(SETTINGS_FILE, "r+");

	if (fp == NULL) {
		LOG_INF("Settings file doesn't exist, will create it");
		return -1;
	}

	if (fseek(fp, 0, SEEK_SET) < 0) {
		return -1;
	}

	int vallen;
	char line[READ_LEN_MAX + 1];

	while (fgets(line, sizeof(line), fp) == line) {
		/* check for matching subtree */
		if (arg->subtree != NULL && !strstr(line, arg->subtree)) {
			continue;
		}

		char *pos = strchr(line, '=');

		if (pos <= line) {
			return -1;
		}

		vallen = strlen(line) - (pos - line) - 2;
		LOG_DBG("loading entry: %s", line);

		struct line_read_ctx valctx;

		valctx.len = vallen;
		valctx.val = pos + 1;
		int err = settings_call_set_handler(line, vallen / 2, settings_line_read_cb,
						    &valctx, arg);

		if (err < 0) {
			return err;
		}
	};

	return fclose(fp);
}

/* Entries are saved to optimize readability of the settings file for test development and
 * debugging purposes. Format:
 * <entry-key>=<entry-value-hex-str>\n
 */
static int settings_custom_save(struct settings_store *cs, const char *name,
				const char *value, size_t val_len)
{
	FILE *fcur = fopen(SETTINGS_FILE, "r+");
	FILE *fnew = NULL;

	if (fcur == NULL) {
		fcur = fopen(SETTINGS_FILE, "w");
	} else {
		fnew = fopen(SETTINGS_FILE_TMP, "w");
		if (fnew == NULL) {
			LOG_ERR("Failed to create temporary file %s", SETTINGS_FILE_TMP);
			return -1;
		}
	}

	if (fcur == NULL) {
		LOG_ERR("Failed to create settings file: %s", SETTINGS_FILE);
		return -1;
	}

	if (strlen(name) > ENTRY_NAME_MAX_LEN || val_len > SETTINGS_MAX_VAL_LEN) {
		return -1;
	}

	if (fnew != NULL) {
		if (entry_check_and_copy(fcur, fnew, name) < 0) {
			return -1;
		}
	}

	if (val_len) {
		char bufvname[ENTRY_NAME_MAX_LEN + ENTRY_LEN_SIZE + 3];

		snprintk(bufvname, sizeof(bufvname), "%s=", name);
		if (fputs(bufvname, fnew != NULL ? fnew : fcur) < 0) {
			return -1;
		}

		char bufval[ENTRY_VAL_MAX_LEN + 2] = {};
		size_t valcnt = 0;

		while (valcnt < (val_len * 2)) {
			valcnt += snprintk(&bufval[valcnt], 3, "%02x",
					   (uint8_t)value[valcnt / 2]);
		};

		/* helps in making settings file readable */
		bufval[valcnt++] = '\n';
		bufval[valcnt] = 0;

		if (fputs(bufval, fnew != NULL ? fnew : fcur) < 0) {
			return -1;
		}
	}

	if (fnew != NULL) {
		entry_check_and_copy(fcur, fnew, name);
	}

	fclose(fcur);

	if (fnew != NULL) {
		fclose(fnew);

		remove(SETTINGS_FILE);
		rename(SETTINGS_FILE_TMP, SETTINGS_FILE);
	}

	return 0;
}

/* custom backend interface */
static struct settings_store_itf settings_custom_itf = {
	.csi_load = settings_custom_load,
	.csi_save = settings_custom_save,
};

/* custom backend node */
static struct settings_store settings_custom_store = {
	.cs_itf = &settings_custom_itf
};

int settings_backend_init(void)
{
	snprintf(setting_file, sizeof(setting_file), "%s_%s.log", get_simid(), get_settings_file());
	snprintf(setting_file_tmp, sizeof(setting_file_tmp), "~%s", setting_file);

	LOG_INF("file path: %s", SETTINGS_FILE);

	/* register custom backend */
	settings_dst_register(&settings_custom_store);
	settings_src_register(&settings_custom_store);
	return 0;
}

void settings_test_backend_clear(void)
{
	snprintf(setting_file, sizeof(setting_file), "%s_%s.log", get_simid(), get_settings_file());

	if (remove(setting_file)) {
		LOG_INF("error deleting file: %s", setting_file);
	}
}
```

## src/utils.c
```c
/*
 * Copyright (c) 2023 Nordic Semiconductor ASA
 *
 * SPDX-License-Identifier: Apache-2.0
 */

#include "utils.h"
#include "gatt_utils.h"
#include <zephyr/sys/__assert.h>
#include <zephyr/bluetooth/hci.h>

DEFINE_FLAG(flag_is_connected);
DEFINE_FLAG(flag_test_end);

void wait_connected(void)
{
	UNSET_FLAG(flag_is_connected);
	WAIT_FOR_FLAG(flag_is_connected);
	printk("connected\n");

}

void wait_disconnected(void)
{
	SET_FLAG(flag_is_connected);
	WAIT_FOR_FLAG_UNSET(flag_is_connected);
	printk("disconnected\n");
}

static void disconnected(struct bt_conn *conn, uint8_t reason)
{
	bt_conn_unref(conn);
	UNSET_FLAG(flag_is_connected);
	gatt_clear_flags();
}

static void connected(struct bt_conn *conn, uint8_t err)
{
	if (err != 0) {
		return;
	}

	char addr_str[BT_ADDR_LE_STR_LEN];
	bt_addr_le_to_str(bt_conn_get_dst(conn), addr_str, sizeof(addr_str));
	printk("connected: %s", addr_str);

	bt_conn_ref(conn);
	SET_FLAG(flag_is_connected);
}

DEFINE_FLAG(flag_encrypted);

void security_changed(struct bt_conn *conn, bt_security_t level,
		      enum bt_security_err err)
{
	__ASSERT(err == 0, "Error setting security (err %u)\n", err);

	printk("Encrypted\n");
	SET_FLAG(flag_encrypted);
}

BT_CONN_CB_DEFINE(conn_callbacks) = {
	.connected = connected,
	.disconnected = disconnected,
	.security_changed = security_changed,
};

static void scan_connect_to_first_result_device_found(const bt_addr_le_t *addr, int8_t rssi,
						      uint8_t type, struct net_buf_simple *ad)
{
	struct bt_conn *conn;
	char addr_str[BT_ADDR_LE_STR_LEN];
	int err;

	/* We're only interested in connectable events */
	if (type != BT_HCI_ADV_IND && type != BT_HCI_ADV_DIRECT_IND) {
		FAIL("Unexpected advertisement type.");
	}

	bt_addr_le_to_str(addr, addr_str, sizeof(addr_str));
	printk("Got scan result, connecting.. dst %s, RSSI %d\n",
	       addr_str, rssi);

	err = bt_le_scan_stop();
	__ASSERT(!err, "Err bt_le_scan_stop %d", err);

	err = bt_conn_le_create(addr,
				BT_CONN_LE_CREATE_CONN, BT_LE_CONN_PARAM_DEFAULT,
				&conn);
	__ASSERT(!err, "Err bt_conn_le_create %d", err);
}

void scan_connect_to_first_result(void)
{
	int err;

	printk("start scanner\n");
	err = bt_le_scan_start(BT_LE_SCAN_PASSIVE,
			       scan_connect_to_first_result_device_found);
	__ASSERT(!err, "Err bt_le_scan_start %d", err);
}

void advertise_connectable(void)
{
	printk("start advertiser\n");
	int err;
	struct bt_le_adv_param param = {};

	param.interval_min = 0x0020;
	param.interval_max = 0x4000;
	param.options |= BT_LE_ADV_OPT_ONE_TIME;
	param.options |= BT_LE_ADV_OPT_CONNECTABLE;

	err = bt_le_adv_start(&param, NULL, 0, NULL, 0);
	__ASSERT(err == 0, "Advertising failed to start (err %d)\n", err);
}

void disconnect(struct bt_conn *conn)
{
	int err;

	err = bt_conn_disconnect(conn, BT_HCI_ERR_REMOTE_USER_TERM_CONN);
	__ASSERT(!err, "Failed to initate disconnection (err %d)", err);

	printk("Waiting for disconnection...\n");
	WAIT_FOR_FLAG_UNSET(flag_is_connected);
}

static void get_active_conn_cb(struct bt_conn *src, void *dst)
{
	*(struct bt_conn **)dst = src;
}

struct bt_conn *get_conn(void)
{
	struct bt_conn *ret;

	bt_conn_foreach(BT_CONN_TYPE_LE, get_active_conn_cb, &ret);

	return ret;
}

DEFINE_FLAG(flag_pairing_complete);

static void pairing_failed(struct bt_conn *conn, enum bt_security_err reason)
{
	FAIL("Pairing failed (unexpected): reason %u", reason);
}

static void pairing_complete(struct bt_conn *conn, bool bonded)
{
	__ASSERT(bonded, "Bonding failed\n");

	printk("Paired\n");
	SET_FLAG(flag_pairing_complete);
}

static struct bt_conn_auth_info_cb bt_conn_auth_info_cb = {
	.pairing_failed = pairing_failed,
	.pairing_complete = pairing_complete,
};

void set_security(struct bt_conn *conn, bt_security_t sec)
{
	int err;

	UNSET_FLAG(flag_encrypted);

	err = bt_conn_set_security(conn, sec);
	__ASSERT(!err, "Err bt_conn_set_security %d", err);

	WAIT_FOR_FLAG(flag_encrypted);
}

void wait_secured(void)
{
	UNSET_FLAG(flag_encrypted);
	WAIT_FOR_FLAG(flag_encrypted);
}

void bond(struct bt_conn *conn)
{
	UNSET_FLAG(flag_pairing_complete);

	int err = bt_conn_auth_info_cb_register(&bt_conn_auth_info_cb);

	__ASSERT(!err, "bt_conn_auth_info_cb_register failed.\n");

	set_security(conn, BT_SECURITY_L2);

	WAIT_FOR_FLAG(flag_pairing_complete);
}

void wait_bonded(void)
{
	UNSET_FLAG(flag_encrypted);
	UNSET_FLAG(flag_pairing_complete);

	int err = bt_conn_auth_info_cb_register(&bt_conn_auth_info_cb);

	__ASSERT(!err, "bt_conn_auth_info_cb_register failed.\n");

	WAIT_FOR_FLAG(flag_encrypted);
	WAIT_FOR_FLAG(flag_pairing_complete);
}

struct bt_conn *connect_as_central(void)
{
	struct bt_conn *conn;

	scan_connect_to_first_result();
	wait_connected();
	conn = get_conn();

	return conn;
}

struct bt_conn *connect_as_peripheral(void)
{
	struct bt_conn *conn;

	advertise_connectable();
	wait_connected();
	conn = get_conn();

	return conn;
}
```

## src/utils.h
```c
/**
 * Common functions and helpers for BSIM ADV tests
 *
 * Copyright (c) 2022 Nordic Semiconductor ASA
 *
 * SPDX-License-Identifier: Apache-2.0
 */

#include "bs_tracing.h"
#include "bs_types.h"
#include "bstests.h"
#include "time_machine.h"
#include "zephyr/sys/__assert.h"

#include <errno.h>

#include <zephyr/bluetooth/bluetooth.h>
#include <zephyr/bluetooth/conn.h>
#include <zephyr/bluetooth/gatt.h>
#include <zephyr/bluetooth/hci.h>
#include <zephyr/bluetooth/uuid.h>
#include <zephyr/kernel.h>
#include <zephyr/types.h>

extern enum bst_result_t bst_result;

#define DECLARE_FLAG(flag) extern atomic_t flag
#define DEFINE_FLAG(flag)  atomic_t flag = (atomic_t) false
#define SET_FLAG(flag)	   (void)atomic_set(&flag, (atomic_t) true)
#define UNSET_FLAG(flag)   (void)atomic_set(&flag, (atomic_t) false)
#define WAIT_FOR_FLAG(flag)                                                                        \
	while (!(bool)atomic_get(&flag)) {                                                         \
		(void)k_sleep(K_MSEC(1));                                                          \
	}
#define WAIT_FOR_FLAG_UNSET(flag)                                                                  \
	while ((bool)atomic_get(&flag)) {                                                          \
		(void)k_sleep(K_MSEC(1));                                                          \
	}
#define TAKE_FLAG(flag)                                                                            \
	while (!(bool)atomic_cas(&flag, true, false)) {                                            \
		(void)k_sleep(K_MSEC(1));                                                          \
	}

#define ASSERT(expr, ...)                                                                          \
	do {                                                                                       \
		if (!(expr)) {                                                                     \
			FAIL(__VA_ARGS__);                                                         \
		}                                                                                  \
	} while (0)

DECLARE_FLAG(flag_test_end);

#define FAIL(...)					\
	SET_FLAG(flag_test_end);			\
	do {						\
		bst_result = Failed;			\
		bs_trace_error_time_line(__VA_ARGS__);	\
	} while (0)

#define PASS(...)					\
	SET_FLAG(flag_test_end);			\
	do {						\
		bst_result = Passed;			\
		bs_trace_info_time(1, __VA_ARGS__);	\
	} while (0)

void test_tick(bs_time_t HW_device_time);
void test_init(void);
void backchannel_init(void);
void signal_next_test_round(void);
void wait_for_round_start(void);

struct bt_conn* connect_as_central(void);
struct bt_conn* connect_as_peripheral(void);
void disconnect(struct bt_conn *conn);
void wait_disconnected(void);
struct bt_conn* get_conn(void);

void set_security(struct bt_conn *conn, bt_security_t sec);
void wait_secured(void);
void bond(struct bt_conn *conn);
void wait_bonded(void);

void gatt_register_service(bool other);
void gatt_discover(void);
void activate_robust_caching(void);
void read_test_char(bool expect_err);

char *get_settings_file(void);
int get_test_round(void);
void signal_next_test_round(void);
void wait_for_round_start(void);

bool is_final_round(void);
```
