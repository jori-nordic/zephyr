## CMakeLists.txt
```
# SPDX-License-Identifier: Apache-2.0

cmake_minimum_required(VERSION 3.20.0)

find_package(Zephyr REQUIRED HINTS $ENV{ZEPHYR_BASE})

project(multilink_peripheral)

add_subdirectory(${ZEPHYR_BASE}/tests/bluetooth/common/testlib testlib)
target_link_libraries(app PRIVATE testlib)

# This contains babblesim-specific helpers, e.g. device synchronization.
add_subdirectory(${ZEPHYR_BASE}/tests/bsim/babblekit babblekit)
target_link_libraries(app PRIVATE babblekit)

zephyr_include_directories(
  ${BSIM_COMPONENTS_PATH}/libUtilv1/src/
  ${BSIM_COMPONENTS_PATH}/libPhyComv1/src/
)

target_sources(app PRIVATE
  src/main.c
  src/dut.c
  src/peer.c
)
```

## prj.conf
```kconfig
#### Logs, debug, etc options

# I'm a contrarian at heart
CONFIG_ASSERT=y

# More debug
CONFIG_LOG=y
CONFIG_THREAD_NAME=y
CONFIG_LOG_THREAD_ID_PREFIX=y
CONFIG_ARCH_POSIX_TRAP_ON_FATAL=y
# Squelch log noise on bt_init()
# CONFIG_BT_HCI_CORE_LOG_LEVEL_WRN=y

CONFIG_LOG_FUNC_NAME_PREFIX_ERR=y
CONFIG_LOG_FUNC_NAME_PREFIX_WRN=y

CONFIG_APP_LOG_LEVEL_DBG=y
# CONFIG_BT_L2CAP_LOG_LEVEL_DBG=y
# CONFIG_BT_CONN_LOG_LEVEL_DBG=y
# CONFIG_BT_HCI_DRIVER_LOG_LEVEL_DBG=y

#### Test-specific options

CONFIG_BT=y
CONFIG_BT_PERIPHERAL=y
CONFIG_BT_CENTRAL=y

# Dependency of testlib/adv and testlib/scan.
CONFIG_BT_EXT_ADV=y

# Dynamic channel depends on SMP
CONFIG_BT_SMP=y
CONFIG_BT_L2CAP_DYNAMIC_CHANNEL=y

# Disable auto-initiated procedures so they don't
# mess with the test's execution.
CONFIG_BT_AUTO_PHY_UPDATE=n
CONFIG_BT_AUTO_DATA_LEN_UPDATE=n
CONFIG_BT_GAP_AUTO_UPDATE_CONN_PARAMS=n

CONFIG_BT_MAX_CONN=2

# CONFIG_BT_ATT_TX_COUNT=10
# CONFIG_BT_L2CAP_TX_BUF_COUNT=10
# CONFIG_BT_CONN_TX_MAX=10
# CONFIG_BT_BUF_ACL_RX_COUNT=10

# CONFIG_BT_HCI_LOG_HEXDUMP=y
```

## src/main.c
```c
/*
 * Copyright (c) 2024 Nordic Semiconductor ASA
 *
 * SPDX-License-Identifier: Apache-2.0
 */

#include <zephyr/kernel.h>

#include "bs_tracing.h"
#include "bstests.h"
#include "babblekit/testcase.h"

extern void entrypoint_dut(void);
extern void entrypoint_central(void);
extern enum bst_result_t bst_result;


static void test_end_cb(void)
{
	/* This callback will fire right before the executable returns */
	if (bst_result != Passed) {
		TEST_PRINT("Test has not passed.");
	}
}

static const struct bst_test_instance entrypoints[] = {
	{
		.test_id = "dut",
		.test_delete_f = test_end_cb,
		.test_main_f = entrypoint_dut,
	},
	{
		.test_id = "central",
		.test_delete_f = test_end_cb,
		.test_main_f = entrypoint_central,
	},
	BSTEST_END_MARKER,
};

static struct bst_test_list *install(struct bst_test_list *tests)
{
	return bst_add_tests(tests, entrypoints);
};

bst_test_install_t test_installers[] = {install, NULL};

int main(void)
{
	bst_main();

	return 0;
}
```

## src/central.c
```c
/*
 * Copyright (c) 2024 Nordic Semiconductor ASA
 *
 * SPDX-License-Identifier: Apache-2.0
 */

#include <zephyr/kernel.h>
#include <zephyr/bluetooth/bluetooth.h>
#include <zephyr/bluetooth/conn.h>
#include <zephyr/bluetooth/att.h>
#include <zephyr/bluetooth/l2cap.h>
#include <zephyr/logging/log.h>

#include "testlib/scan.h"
#include "testlib/conn.h"

#include "babblekit/flags.h"
#include "babblekit/sync.h"
#include "babblekit/testcase.h"

/* local includes */
#include "data.h"

LOG_MODULE_REGISTER(central, CONFIG_APP_LOG_LEVEL);

static int total_rx;
static struct bt_l2cap_le_chan le_chan;

void sent_cb(struct bt_l2cap_chan *chan)
{
	TEST_FAIL("Tester should not send data");
}

int recv_cb(struct bt_l2cap_chan *chan, struct net_buf *buf)
{
	/* TODO: verify data is in sequence */
	LOG_DBG("received %d bytes", buf->len);
	total_rx++;

	return 0;
}

void l2cap_chan_connected_cb(struct bt_l2cap_chan *chan)
{
	LOG_DBG("%p", chan);
}

void l2cap_chan_disconnected_cb(struct bt_l2cap_chan *chan)
{
	LOG_DBG("%p", chan);
}

static struct bt_l2cap_chan_ops ops = {
	.connected = l2cap_chan_connected_cb,
	.disconnected = l2cap_chan_disconnected_cb,
	.recv = recv_cb,
	.sent = sent_cb,
};

int server_accept_cb(struct bt_conn *conn,
		     struct bt_l2cap_server *server,
		     struct bt_l2cap_chan **chan)
{
	memset(&le_chan, 0, sizeof(le_chan));
	le_chan.chan.ops = &ops;
	*chan = &le_chan.chan;

	return 0;
}

static struct bt_l2cap_server test_l2cap_server = {
	.accept = server_accept_cb
};

static int l2cap_server_register(bt_security_t sec_level)
{
	test_l2cap_server.psm = 0;
	test_l2cap_server.sec_level = sec_level;

	int err = bt_l2cap_server_register(&test_l2cap_server);

	TEST_ASSERT(err == 0, "Failed to register l2cap server (err %d)", err);

	return test_l2cap_server.psm;
}

static void acl_connected(struct bt_conn *conn, uint8_t err)
{
	char addr[BT_ADDR_LE_STR_LEN];

	bt_addr_le_to_str(bt_conn_get_dst(conn), addr, sizeof(addr));

	if (err) {
		LOG_ERR("Failed to connect to %s (0x%02x)", addr, err);
		return;
	}

	LOG_DBG("Connected to %s", addr);
}

static void acl_disconnected(struct bt_conn *conn, uint8_t reason)
{
	char addr[BT_ADDR_LE_STR_LEN];

	bt_addr_le_to_str(bt_conn_get_dst(conn), addr, sizeof(addr));

	LOG_DBG("Disconnected from %s (reason 0x%02x)", addr, reason);
}

static struct bt_conn_cb central_cb = {
	.connected = acl_connected,
	.disconnected = acl_disconnected,
};

/* Read the comments on `entrypoint_dut()` first. */
extern enum bt_conn_state bt_conn_state(struct bt_conn *conn);



void entrypoint_central(void)
{
	int err;
	struct bt_conn *conn = NULL;
	bt_addr_le_t dut;

	/* Mark test as in progress. */
	TEST_START("central");

	/* Initialize Bluetooth */
	err = bt_conn_cb_register(&central_cb);
	TEST_ASSERT(err == 0, "Can't register callbacks (err %d)", err);

	err = bt_enable(NULL);
	TEST_ASSERT(err == 0, "Can't enable Bluetooth (err %d)", err);

	LOG_DBG("Bluetooth initialized");

	int psm = l2cap_server_register(BT_SECURITY_L1);

	LOG_DBG("Registered server PSM %x", psm);

	err = bt_testlib_scan_find_name(&dut, DUT_NAME);
	TEST_ASSERT(!err, "Failed to start scan (err %d)", err);

	/* DUT will terminate all devices when it's done */
	TEST_PASS("central");

	while (total_rx < SDU_NUM) {
		/* Create a connection using that address */
		err = bt_testlib_connect(&dut, &conn);
		TEST_ASSERT(!err, "Failed to initiate connection (err %d)", err);
		TEST_ASSERT(bt_conn_state(conn) == BT_CONN_STATE_CONNECTED, "ohnoes");

		LOG_DBG("Connected");

		int i = 0;
		/* Receive in the background */
		for (i=0; i<100; i++) {
			k_sleep(K_MSEC(10));
			if (bt_conn_state(conn) != BT_CONN_STATE_CONNECTED) {
				bt_testlib_conn_unref(&conn);
				break;
			}
		}
		if (!conn) {
			continue;
		}

		/* Disconnect and destroy connection object */
		/* TODO: more chaos */
		err = bt_testlib_disconnect(&conn, BT_HCI_ERR_REMOTE_USER_TERM_CONN);
		if (err) {
			TEST_ASSERT(!err, "Failed to disconnect (err %d)", err);
		}

		LOG_DBG("Disconnected");

		k_sleep(K_MSEC(1000));
	}
}
```

## src/data.h
```c
/*
 * Copyright (c) 2024 Nordic Semiconductor ASA
 *
 * SPDX-License-Identifier: Apache-2.0
 */

#ifndef ZEPHYR_TESTS_BSIM_BLUETOOTH_HOST_L2CAP_MULTILINK_PERIPHERAL_SRC_DATA_H_
#define ZEPHYR_TESTS_BSIM_BLUETOOTH_HOST_L2CAP_MULTILINK_PERIPHERAL_SRC_DATA_H_

#define SDU_NUM 200		/* Number of SDU (L2CAP buffers) to send  */
#define SDU_LEN 20		/* Length in bytes of said SDUs */
#define DUT_NAME "dee-yu-tee"	/* name to advertise with */

#endif /* ZEPHYR_TESTS_BSIM_BLUETOOTH_HOST_L2CAP_MULTILINK_PERIPHERAL_SRC_DATA_H_ */
```

## src/dut.c
```c
/*
 * Copyright (c) 2024 Nordic Semiconductor ASA
 *
 * SPDX-License-Identifier: Apache-2.0
 */

#include <zephyr/kernel.h>
#include <zephyr/bluetooth/bluetooth.h>
#include <zephyr/bluetooth/conn.h>
#include <zephyr/bluetooth/l2cap.h>
#include <zephyr/logging/log.h>

#include "babblekit/flags.h"
#include "babblekit/testcase.h"

/* local includes */
#include "data.h"

LOG_MODULE_REGISTER(dut, CONFIG_APP_LOG_LEVEL);

static DEFINE_FLAG(ADVERTISING);

static void sdu_destroy(struct net_buf *buf)
{
	LOG_DBG("%p", buf);

	net_buf_destroy(buf);
}

/* Only one SDU per link will be transmitted at a time */
NET_BUF_POOL_DEFINE(sdu_tx_pool,
		    CONFIG_BT_MAX_CONN, BT_L2CAP_SDU_BUF_SIZE(SDU_LEN),
		    CONFIG_BT_CONN_TX_USER_DATA_SIZE, sdu_destroy);

static uint8_t tx_data[SDU_LEN];

struct test_ctx {
	bt_addr_le_t peer;
	struct bt_l2cap_le_chan le_chan;
	size_t sdu_count;	/* the number of SDUs that have been transferred until now */
};

static struct test_ctx contexts[CONFIG_BT_MAX_CONN];

static struct test_ctx *get_ctx_from_chan(struct bt_l2cap_chan *chan)
{
	struct bt_l2cap_le_chan *le_chan = CONTAINER_OF(chan, struct bt_l2cap_le_chan, chan);
	struct test_ctx *ctx = CONTAINER_OF(le_chan, struct test_ctx, le_chan);

	TEST_ASSERT(PART_OF_ARRAY(contexts, ctx), "memory corruption");

	return ctx;
}

static struct test_ctx *get_ctx_from_address(const bt_addr_le_t *address)
{
	for (int i = 0; i < ARRAY_SIZE(contexts); i++) {
		struct test_ctx *context = &contexts[i];

		if (bt_addr_le_eq(address, &context->peer)) {
			return context;
		}
	}

	return NULL;
}

static bool addr_in_use(bt_addr_le_t *address)
{
	return !bt_addr_le_eq(address, BT_ADDR_LE_ANY);
}

static struct test_ctx *alloc_ctx(void)
{
	for (int i = 0; i < ARRAY_SIZE(contexts); i++) {
		struct test_ctx *context = &contexts[i];
		struct bt_l2cap_le_chan *le_chan = &context->le_chan;

		if (le_chan->state != BT_L2CAP_DISCONNECTED) {
			continue;
		}

		if (addr_in_use(&context->peer)) {
			continue;
		}

		memset(context, 0, sizeof(struct test_ctx));

		return context;
	}

	return NULL;
}

static int send_data_over_l2cap(struct bt_l2cap_chan *chan, uint8_t *data, size_t len)
{
	char addr[BT_ADDR_LE_STR_LEN];

	bt_addr_le_to_str(bt_conn_get_dst(chan->conn), addr, sizeof(addr));

	LOG_DBG("[%s] chan %p data %p len %d", addr, chan, data, len);

	struct net_buf *buf = net_buf_alloc(&sdu_tx_pool, K_NO_WAIT);

	if (buf == NULL) {
		TEST_FAIL("No more memory");
		return -ENOMEM;
	}

	net_buf_reserve(buf, BT_L2CAP_SDU_CHAN_SEND_RESERVE);
	net_buf_add_mem(buf, data, len);

	int ret = bt_l2cap_chan_send(chan, buf);

	TEST_ASSERT(ret == 0, "Failed sending: err %d", ret);
	LOG_DBG("queued SDU", len);

	return ret;
}

static void continue_sending(struct test_ctx *ctx)
{
	struct bt_l2cap_chan *chan = &ctx->le_chan.chan;

	TEST_ASSERT(ctx->le_chan.state == BT_L2CAP_CONNECTED, "such race much wow");

	LOG_DBG("%p, transmitted %d SDUs", chan, ctx->sdu_count);

	if (ctx->sdu_count < SDU_NUM) {
		send_data_over_l2cap(chan, tx_data, sizeof(tx_data));
	} else {
		char addr[BT_ADDR_LE_STR_LEN];

		bt_addr_le_to_str(bt_conn_get_dst(chan->conn), addr, sizeof(addr));

		LOG_DBG("[%s] Done sending", addr);
	}
}

static void sent_cb(struct bt_l2cap_chan *chan)
{
	struct test_ctx *ctx = get_ctx_from_chan(chan);

	LOG_DBG("%p", chan);

	ctx->sdu_count++;

	continue_sending(ctx);
}

static int recv_cb(struct bt_l2cap_chan *chan, struct net_buf *buf)
{
	TEST_FAIL("DUT should not receive data");

	return 0;
}

static void l2cap_chan_connected_cb(struct bt_l2cap_chan *chan)
{
	struct bt_l2cap_le_chan *le_chan =
		CONTAINER_OF(chan, struct bt_l2cap_le_chan, chan);

	LOG_DBG("%p (tx mtu %d mps %d) (tx mtu %d mps %d)",
		chan,
		le_chan->tx.mtu,
		le_chan->tx.mps,
		le_chan->rx.mtu,
		le_chan->rx.mps);

	LOG_DBG("initiating SDU transfer");
	continue_sending(get_ctx_from_chan(chan));
}

static void l2cap_chan_disconnected_cb(struct bt_l2cap_chan *chan)
{
	LOG_DBG("%p", chan);
}

static struct bt_l2cap_chan_ops ops = {
	.connected = l2cap_chan_connected_cb,
	.disconnected = l2cap_chan_disconnected_cb,
	.recv = recv_cb,
	.sent = sent_cb,
};

static int connect_l2cap_channel(struct bt_conn *conn, struct bt_l2cap_le_chan *le_chan)
{
	memset(le_chan, 0, sizeof(*le_chan));
	le_chan->chan.ops = &ops;

	return bt_l2cap_chan_connect(conn, &le_chan->chan, 0x0080);
}

static void acl_connected(struct bt_conn *conn, uint8_t err)
{
	char addr[BT_ADDR_LE_STR_LEN];
	struct test_ctx *ctx;

	bt_addr_le_to_str(bt_conn_get_dst(conn), addr, sizeof(addr));

	TEST_ASSERT(err == 0, "Failed to connect to %s (0x%02x)", addr, err);

	UNSET_FLAG(ADVERTISING);

	LOG_DBG("[%s] Connected (conn %p)", addr, conn);

	ctx = get_ctx_from_address(bt_conn_get_dst(conn));
	if (ctx == NULL) {
		LOG_WRN("no context for %s, allocating", addr);
		ctx = alloc_ctx();
		TEST_ASSERT(ctx, "please download more RAM");

		bt_addr_le_copy(&ctx->peer, bt_conn_get_dst(conn));
	}

	int ret = connect_l2cap_channel(conn, &ctx->le_chan);
	TEST_ASSERT(!ret, "Error connecting l2cap channel (err %d)", ret);
}

static void acl_disconnected(struct bt_conn *conn, uint8_t reason)
{
	char addr[BT_ADDR_LE_STR_LEN];

	bt_addr_le_to_str(bt_conn_get_dst(conn), addr, sizeof(addr));

	LOG_DBG("Disconnected from %s (reason 0x%02x)", addr, reason);
}

static struct bt_conn_cb peripheral_cb = {
	.connected = acl_connected,
	.disconnected = acl_disconnected,
};

static void increment(struct bt_conn *conn, void *user_data)
{
	int *conn_count = user_data;

	(*conn_count)++;
}

static bool have_free_conn(void)
{
	int conn_count = 0;

	bt_conn_foreach(BT_CONN_TYPE_LE, increment, &conn_count);

	return conn_count < CONFIG_BT_MAX_CONN;
}

static const struct bt_data ad[] = {
	BT_DATA_BYTES(BT_DATA_FLAGS, (BT_LE_AD_GENERAL | BT_LE_AD_NO_BREDR)),
	BT_DATA(BT_DATA_NAME_COMPLETE, DUT_NAME, sizeof(DUT_NAME) - 1),
};

static void start_advertising(void)
{
	int err;

	if (!have_free_conn() || IS_FLAG_SET(ADVERTISING)) {
		return;
	}

	LOG_DBG("starting advertiser");

	err = bt_le_adv_start(BT_LE_ADV_CONN_ONE_TIME, ad, ARRAY_SIZE(ad), NULL, 0);
	TEST_ASSERT(!err, "Advertising failed to start (err %d)", err);

	SET_FLAG(ADVERTISING);
}

static bool all_data_transferred(void)
{
	int total_sdu_count = 0;

	for (int i = 0; i < ARRAY_SIZE(contexts); i++) {
		total_sdu_count += contexts[i].sdu_count;
	}

	TEST_ASSERT(total_sdu_count <= (SDU_NUM * CONFIG_BT_MAX_CONN),
		    "this host is just too good!");

	return total_sdu_count == (SDU_NUM * CONFIG_BT_MAX_CONN);
}

void entrypoint_dut(void)
{
	/* Test purpose:
	 *
	 * For a peripheral device (DUT) that has multiple ACL connections to
	 * central devices: Verify that the data streams on one connection are
	 * not affected by one of the centrals going out of range or not
	 * responding.
	 *
	 * Three devices:
	 * - `dut`: sends L2CAP packets to p0, p1 and p2
	 *
	 * DUT (in a loop):
	 * - advertise as connectable
	 * - [acl connected]
	 * - establish L2CAP channel
	 * - send L2CAP data until ACL disconnected or SDU_NUM SDUs reached
	 *
	 * p0/1/2 (in a loop):
	 * - scan & connect ACL
	 * - [acl connected]
	 * - [l2cap dynamic channel connected]
	 * - receive data from DUT
	 * - disconnect
	 *
	 * Verdict:
	 * - DUT is able to transfer SDU_NUM SDUs to all peers. Data can be
	 * dropped but resources should not leak, and the transfer should not
	 * stall.
	 */
	int err;

	/* Mark test as in progress. */
	TEST_START("dut");

	/* Initialize Bluetooth */
	err = bt_conn_cb_register(&peripheral_cb);
	TEST_ASSERT(err == 0, "Can't register callbacks (err %d)", err);

	err = bt_enable(NULL);
	TEST_ASSERT(err == 0, "Can't enable Bluetooth (err %d)", err);

	LOG_DBG("Bluetooth initialized");

	while (!all_data_transferred()) {
		start_advertising();

		/* TODO: do we want a state machine instead? */

		/* L2 channel is opened from conn->connected() */
		/* L2 data transfer is initiated from l2->connected() */
		/* L2 data transfer is initiated for next SDU from l2->sent() */

		/* TODO: data integrity/re-ordering verification */

		k_sleep(K_MSEC(10));
	}

	TEST_PASS_AND_EXIT("dut");
}
```

## src/peer.c
```c
/*
 * Copyright (c) 2024 Nordic Semiconductor ASA
 *
 * SPDX-License-Identifier: Apache-2.0
 */

#include <zephyr/kernel.h>
#include <zephyr/bluetooth/bluetooth.h>
#include <zephyr/bluetooth/conn.h>
#include <zephyr/bluetooth/att.h>
#include <zephyr/bluetooth/gatt.h>
#include <zephyr/logging/log.h>

#include "testlib/adv.h"
#include "testlib/conn.h"

#include "babblekit/flags.h"
#include "babblekit/sync.h"
#include "babblekit/testcase.h"

/* local includes */
#include "data.h"

LOG_MODULE_REGISTER(peer, CONFIG_APP_LOG_LEVEL);

/* Read the comments on `entrypoint_dut()` first. */
void entrypoint_peer(void)
{
	int err;
	struct bt_conn *conn;
	uint16_t handle;

	/* Mark test as in progress. */
	TEST_START("peer");

	/* Initialize Bluetooth */
	err = bt_enable(NULL);
	TEST_ASSERT(err == 0, "Can't enable Bluetooth (err %d)", err);

	LOG_DBG("Bluetooth initialized");

	err = bt_testlib_adv_conn(&conn, BT_ID_DEFAULT, bt_get_name());
	TEST_ASSERT(!err, "Failed to start connectable advertising (err %d)", err);

	/* Disconnect and destroy connection object */
	LOG_DBG("Disconnect");
	err = bt_testlib_disconnect(&conn, BT_HCI_ERR_REMOTE_USER_TERM_CONN);
	TEST_ASSERT(!err, "Failed to disconnect (err %d)", err);

	TEST_PASS("peer");
}
```
