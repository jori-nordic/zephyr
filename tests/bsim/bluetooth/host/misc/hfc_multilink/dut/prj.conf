## prj.conf
```kconfig
CONFIG_LOG=y
CONFIG_ASSERT=y
CONFIG_THREAD_NAME=y
CONFIG_LOG_THREAD_ID_PREFIX=y
CONFIG_ARCH_POSIX_TRAP_ON_FATAL=y

CONFIG_APP_LOG_LEVEL_DBG=y
# CONFIG_BT_CONN_LOG_LEVEL_DBG=y
# CONFIG_BT_ATT_LOG_LEVEL_DBG=y
# CONFIG_BT_GATT_LOG_LEVEL_DBG=y

CONFIG_BT=y
CONFIG_BT_DEVICE_NAME="sample-test"
CONFIG_BT_CENTRAL=y

# Dependency of testlib/adv and testlib/scan.
CONFIG_BT_EXT_ADV=y

# Dynamic channel depends on SMP
CONFIG_BT_SMP=y
CONFIG_BT_L2CAP_DYNAMIC_CHANNEL=y

# Disable auto-initiated procedures so they don't
# mess with the test's execution.
CONFIG_BT_AUTO_PHY_UPDATE=n
CONFIG_BT_AUTO_DATA_LEN_UPDATE=n
CONFIG_BT_GAP_AUTO_UPDATE_CONN_PARAMS=n

CONFIG_BT_MAX_CONN=3
CONFIG_BT_BUF_ACL_RX_COUNT=4

# This test will fail when CONFIG_BT_MAX_CONN == CONFIG_BT_BUF_ACL_RX_COUNT
# CONFIG_BT_BUF_ACL_RX_COUNT=3

CONFIG_BT_HCI_ACL_FLOW_CONTROL=y
CONFIG_BUILD_OUTPUT_STRIP_PATHS=n
CONFIG_NET_BUF_POOL_USAGE=y
```

## src/dut.c
```c
/*
 * Copyright (c) 2024 Nordic Semiconductor ASA
 *
 * SPDX-License-Identifier: Apache-2.0
 */

#include <zephyr/kernel.h>
#include <zephyr/bluetooth/bluetooth.h>
#include <zephyr/bluetooth/conn.h>
#include <zephyr/bluetooth/l2cap.h>
#include <zephyr/logging/log.h>

#include "testlib/conn.h"
#include "testlib/scan.h"

#include "babblekit/flags.h"
#include "babblekit/testcase.h"

/* local includes */
#include "data.h"
#include "zephyr/net/buf.h"
#include "zephyr/sys/atomic_types.h"

LOG_MODULE_REGISTER(dut, CONFIG_APP_LOG_LEVEL);

#define NUM_TESTERS CONFIG_BT_MAX_CONN

/* Build with the minimum possible amount of RX buffers */
BUILD_ASSERT(CONFIG_BT_BUF_ACL_RX_COUNT == (CONFIG_BT_MAX_CONN + 1));

struct tester {
	size_t sdu_count;
	struct bt_conn *conn;
	struct bt_l2cap_le_chan le_chan;
	struct k_fifo ack_todo;
};

static struct tester testers[NUM_TESTERS];

static struct tester *get_tester(struct bt_conn *conn)
{
	for (size_t i = 0; i < ARRAY_SIZE(testers); i++) {
		if (testers[i].conn == conn) {
			return &testers[i];
		}
	}

	return NULL;
}

static void sent_cb(struct bt_l2cap_chan *chan)
{
	TEST_FAIL("Tester should not send data");
}

static int recv_cb(struct bt_l2cap_chan *chan, struct net_buf *buf)
{
	char addr[BT_ADDR_LE_STR_LEN];
	struct tester *tester = get_tester(chan->conn);

	tester->sdu_count += 1;

	bt_addr_le_to_str(bt_conn_get_dst(chan->conn), addr, sizeof(addr));

	LOG_INF("Received SDU %p %d / %d from (%s)", buf, tester->sdu_count, SDU_NUM, addr);

	__ASSERT_NO_MSG(*(void**)buf == NULL);
	net_buf_put(&tester->ack_todo, buf);

	return -EINPROGRESS;
}

static void l2cap_chan_connected_cb(struct bt_l2cap_chan *chan)
{
	LOG_DBG("%p", chan);
}

static void l2cap_chan_disconnected_cb(struct bt_l2cap_chan *chan)
{
	LOG_DBG("%p", chan);
}

static int server_accept_cb(struct bt_conn *conn, struct bt_l2cap_server *server,
			    struct bt_l2cap_chan **chan)
{
	static struct bt_l2cap_chan_ops ops = {
		.connected = l2cap_chan_connected_cb,
		.disconnected = l2cap_chan_disconnected_cb,
		.recv = recv_cb,
		.sent = sent_cb,
	};

	struct tester *tester = get_tester(conn);
	struct bt_l2cap_le_chan *le_chan = &tester->le_chan;

	k_fifo_init(&tester->ack_todo);
	memset(le_chan, 0, sizeof(*le_chan));
	le_chan->chan.ops = &ops;
	*chan = &le_chan->chan;

	return 0;
}

static int l2cap_server_register(bt_security_t sec_level)
{
	static struct bt_l2cap_server test_l2cap_server = {.accept = server_accept_cb};

	test_l2cap_server.psm = L2CAP_TEST_PSM;
	test_l2cap_server.sec_level = sec_level;

	int err = bt_l2cap_server_register(&test_l2cap_server);

	TEST_ASSERT(err == 0, "Failed to register l2cap server (err %d)", err);

	return test_l2cap_server.psm;
}

static struct bt_conn *connect_tester(void)
{
	int err;
	bt_addr_le_t tester = {};
	struct bt_conn *conn = NULL;
	char addr[BT_ADDR_LE_STR_LEN];

	/* The device address will not change. Scan only once in order to reduce
	 * test time.
	 */
	err = bt_testlib_scan_find_name(&tester, TESTER_NAME);
	TEST_ASSERT(!err, "Failed to start scan (err %d)", err);

	/* Create a connection using that address */
	err = bt_testlib_connect(&tester, &conn);
	TEST_ASSERT(!err, "Failed to initiate connection (err %d)", err);

	bt_addr_le_to_str(bt_conn_get_dst(conn), addr, sizeof(addr));
	LOG_DBG("Connected to %s", addr);

	return conn;
}

static bool all_data_transferred(void)
{
	size_t total_sdu_count = 0;

	for (size_t i = 0; i < ARRAY_SIZE(testers); i++) {
		total_sdu_count += testers[i].sdu_count;
	}

	TEST_ASSERT(total_sdu_count <= (SDU_NUM * NUM_TESTERS), "Received more SDUs than expected");

	return total_sdu_count == (SDU_NUM * NUM_TESTERS);
}

void entrypoint_dut(void)
{
	/* Multilink Host Flow Control (HFC) test
	 *
	 * Test purpose:
	 *
	 * Verifies that we are able to do L2CAP recombination on multiple links
	 * when we have the smallest possible amount of ACL buffers.
	 *
	 * Devices:
	 * - `dut`: receives L2CAP PDUs from testers
	 * - `tester`: send ACL packets (parts of large L2CAP PDU) very slowly
	 *
	 * Procedure:
	 *
	 * DUT:
	 * - establish connection to tester
	 * - [acl connected]
	 * - establish L2CAP channel
	 * - [l2 connected]
	 * - receive L2CAP PDUs until SDU_NUM is reached
	 * - mark test as passed and terminate simulation
	 *
	 * tester 0/1/2:
	 * - scan & connect ACL
	 * - [acl connected]
	 * - [l2cap dynamic channel connected]
	 * (and then in a loop)
	 * - send part of L2CAP PDU
	 * - wait a set amount of time
	 * - exit loop when SDU_NUM sent
	 *
	 * [verdict]
	 * - dut application is able to receive all expected L2CAP packets from
	 *   the testers
	 */
	int err;

	/* Mark test as in progress. */
	TEST_START("dut");

	/* Initialize Bluetooth */
	err = bt_enable(NULL);
	TEST_ASSERT(err == 0, "Can't enable Bluetooth (err %d)", err);

	LOG_DBG("Bluetooth initialized");

	int psm = l2cap_server_register(BT_SECURITY_L1);

	LOG_DBG("Registered server PSM %x", psm);

	for (size_t i = 0; i < ARRAY_SIZE(testers); i++) {
		LOG_DBG("Connecting tester %d", i);
		testers[i].sdu_count = 0;
		testers[i].conn = connect_tester();
	}

	LOG_DBG("Connected all testers");

	while (!all_data_transferred()) {
		struct net_buf *cmd[CONFIG_BT_BUF_CMD_TX_COUNT];

		/* Allocate all the CMD buffers to starve the command pipeline. */
		for (size_t i = 0; i < ARRAY_SIZE(cmd); i++) {
			cmd[i] = NULL;
			cmd[i] = bt_hci_cmd_create(BT_HCI_OP_READ_LOCAL_VERSION_INFO, 0);
			if (!cmd[i]) {
				k_oops();
			}
		}
		LOG_WRN("allocated");

		/* Wait until we have received all expected data. */
		k_sleep(K_MSEC(100));
		struct net_buf_pool *pool = net_buf_pool_get(cmd[0]->pool_id);
		(void)pool;

		for (size_t i = 0; i < ARRAY_SIZE(testers); i++) {
			struct net_buf *ack_buf = net_buf_get(&testers[i].ack_todo, K_NO_WAIT);
			if (ack_buf) {
				err = bt_l2cap_chan_recv_complete(&testers[i].le_chan.chan, ack_buf);
				if (err) {
					k_oops();
				}
			}
		}

		LOG_WRN("deallocating");
		for (size_t i = 0; i < ARRAY_SIZE(cmd); i++) {
			LOG_WRN("delet %p", cmd[i]);
			int err = bt_hci_cmd_send(BT_HCI_OP_READ_LOCAL_VERSION_INFO, cmd[i]);
			if (err) {
				k_oops();
			}
			cmd[i] = NULL;
		}
	}

	TEST_PASS_AND_EXIT("dut");
}
```
