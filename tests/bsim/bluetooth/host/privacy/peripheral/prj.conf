## prj.conf
```kconfig
CONFIG_BT=y
CONFIG_BT_PERIPHERAL=y
CONFIG_BT_CENTRAL=y
CONFIG_BT_SMP=y
CONFIG_ASSERT=y

CONFIG_BT_EXT_ADV=y
CONFIG_BT_PRIVACY=y
CONFIG_BT_RPA_TIMEOUT=10

# Enable this to solve all your problems
# CONFIG_LOG=y
```

## src/dut.c
```c
/*
 * Copyright (c) 2023 Nordic Semiconductor ASA
 *
 * SPDX-License-Identifier: Apache-2.0
 */

#include "bs_bt_utils.h"

#include <stdint.h>
#include <string.h>

#include <zephyr/bluetooth/addr.h>
#include <zephyr/bluetooth/bluetooth.h>
#include <zephyr/bluetooth/conn.h>
#include <zephyr/toolchain/gcc.h>

bool cb_rpa_expired(struct bt_le_ext_adv *adv)
{
	printk("### RPA expired\n");
	backchannel_sync_send();

	/* Return true to rotate the current RPA */
	return true;
}

void start_advertising(void)
{
	int err;
	static struct bt_le_ext_adv_cb cb_adv;
	struct bt_le_ext_adv_start_param start_params;
	struct bt_le_ext_adv *adv;

	/* Enable bluetooth */
	err = bt_enable(NULL);
	if (err) {
		FAIL("Failed to enable bluetooth (err %d\n)", err);
	}

	/* Start non-connectable extended advertising with private address */
	start_params.timeout = 0;
	start_params.num_events = 0;
	cb_adv.rpa_expired = cb_rpa_expired;

	err = bt_le_ext_adv_create(BT_LE_EXT_ADV_CONN_NAME, &cb_adv, &adv);
	if (err) {
		FAIL("Failed to create advertising set (err %d)\n", err);
	}

	err = bt_le_ext_adv_start(adv, &start_params);
	if (err) {
		FAIL("Failed to enable periodic advertising (err %d)\n", err);
	}
}

void dut_procedure(void)
{
	/* Setup synchronization channel */
	backchannel_init(TESTER_CENTRAL_ID);

	start_advertising();

	/* Nothing to do */

	PASS("PASS\n");
}
```

## src/dut_rpa_rotation.c
```c
/*
 * Copyright (c) 2023 Nordic Semiconductor ASA
 *
 * SPDX-License-Identifier: Apache-2.0
 */

#include "bs_bt_utils.h"

#include <stdint.h>
#include <string.h>

#include <zephyr/bluetooth/addr.h>
#include <zephyr/bluetooth/bluetooth.h>
#include <zephyr/bluetooth/conn.h>
#include <zephyr/toolchain.h>
#include <zephyr/settings/settings.h>

#include "common/bt_str.h"

#define ID_A_INDEX 1
#define ID_B_INDEX 2

#define ADV_SET_INDEX_ONE   0x00
#define ADV_SET_INDEX_TWO   0x01
#define ADV_SET_INDEX_THREE 0x02
#define ADV_SET_INDEX_FOUR  0x03

static struct bt_le_ext_adv *adv_set[CONFIG_BT_EXT_ADV_MAX_ADV_SET];

static const struct bt_data ad_id[] = {
	BT_DATA_BYTES(BT_DATA_MANUFACTURER_DATA, ADV_SET_INDEX_ONE),
	BT_DATA_BYTES(BT_DATA_MANUFACTURER_DATA, ADV_SET_INDEX_TWO),
	BT_DATA_BYTES(BT_DATA_MANUFACTURER_DATA, ADV_SET_INDEX_THREE),
};

bool cb_rpa_expired(struct bt_le_ext_adv *adv)
{
	/* Return true to rotate the current RPA */
	int err;
	struct bt_le_ext_adv_info info;

	err = bt_le_ext_adv_get_info(adv, &info);
	if (err) {
		return false;
	}
	printk("advertiser[%d] RPA %s\n", info.id, bt_addr_le_str(info.addr));
	return true;
}

static void create_adv(struct bt_le_ext_adv **adv, int id)
{
	int err;
	struct bt_le_adv_param params;
	static struct bt_le_ext_adv_cb cb_adv;

	cb_adv.rpa_expired = cb_rpa_expired;
	memset(&params, 0, sizeof(struct bt_le_adv_param));

	params.options |= BT_LE_ADV_OPT_EXT_ADV;
	params.id = id;
	params.sid = 0;
	params.interval_min = BT_GAP_ADV_FAST_INT_MIN_1;
	params.interval_max = BT_GAP_ADV_FAST_INT_MAX_1;

	err = bt_le_ext_adv_create(&params, &cb_adv, adv);
	if (err) {
		FAIL("Failed to create advertiser (%d)\n", err);
	}
}

void start_advertising(void)
{
	int err;
	size_t bt_id_count;

	/* Enable bluetooth */
	err = bt_enable(NULL);
	if (err) {
		FAIL("Failed to enable bluetooth (err %d\n)", err);
	}

	err = settings_load();
	if (err) {
		FAIL("Failed to enable settings (err %d\n)", err);
	}

	bt_id_get(NULL, &bt_id_count);
	if (bt_id_count == 1) {
		int id_a;
		int id_b;

		printk("No extra identity found in settings, creating new ones...\n");

		id_a = bt_id_create(NULL, NULL);
		if (id_a != ID_A_INDEX) {
			FAIL("bt_id_create id_a failed (err %d)\n", id_a);
		}

		id_b = bt_id_create(NULL, NULL);
		if (id_b != ID_B_INDEX) {
			FAIL("bt_id_create id_b failed (err %d)\n", id_b);
		}
	} else {
		printk("Extra identities loaded from settings\n");
	}

	bt_id_get(NULL, &bt_id_count);
	if (bt_id_count != CONFIG_BT_ID_MAX) {
		FAIL("bt_id_get returned incorrect number of identities %u\n", bt_id_count);
	}

	for (int i = 0; i < CONFIG_BT_EXT_ADV_MAX_ADV_SET; i++) {

		/* Create first 2 advertising sets with one id and remaining with another id */
		if (i < 2) {
			create_adv(&adv_set[i], ID_A_INDEX);
		} else {
			create_adv(&adv_set[i], ID_B_INDEX);
		}

		/* Set extended advertising data */
		err = bt_le_ext_adv_set_data(adv_set[i], &ad_id[i], 1, NULL, 0);
		if (err) {
			FAIL("Failed to set advertising data for set %d (err %d)\n", i, err);
		}

		err = bt_le_ext_adv_start(adv_set[i], BT_LE_EXT_ADV_START_DEFAULT);
		if (err) {
			FAIL("Failed to start advertising (err %d)\n", err);
		}
	}
}

void dut_procedure(void)
{
	start_advertising();

	/* Nothing to do */
	PASS("PASS\n");
}
```

## src/tester.c
```c
/*
 * Copyright (c) 2023 Nordic Semiconductor ASA
 *
 * SPDX-License-Identifier: Apache-2.0
 */

#include "bs_bt_utils.h"
#include "zephyr/bluetooth/addr.h"
#include "zephyr/bluetooth/conn.h"
#include <stdint.h>
#include <zephyr/bluetooth/bluetooth.h>

static volatile int64_t old_time, new_time;
static bt_addr_le_t old_addr;
static bt_addr_le_t *new_addr;

static void cb_device_found(const bt_addr_le_t *addr, int8_t rssi, uint8_t type,
			    struct net_buf_simple *ad)
{
	static bool init;

	/* printk("------------------------> DEVICE FOUND\n"); */
	if (!init) {
		old_addr = *addr;
		old_time = k_uptime_get();
		init = true;
	}

	new_addr = (bt_addr_le_t *)addr;
	new_time = k_uptime_get();
}

void start_scanning(void)
{
	int err;
	struct bt_le_scan_param params;

	/* Enable bluetooth */
	err = bt_enable(NULL);
	if (err) {
		FAIL("Failed to enable bluetooth (err %d\n)", err);
	}

	/* Start passive scanning */
	params.type = BT_LE_SCAN_TYPE_PASSIVE;
	params.options = BT_LE_SCAN_OPT_FILTER_DUPLICATE;
	params.interval = BT_GAP_SCAN_FAST_INTERVAL;
	params.window = BT_GAP_SCAN_FAST_WINDOW;

	err = bt_le_scan_start(&params, cb_device_found);
	if (err) {
		FAIL("Failed to start scanning");
	}
}

void tester_procedure(void)
{
	int err;

	/* Setup synchronization channel */
	backchannel_init(DUT_PERIPHERAL_ID);

	k_msleep(1000);

	start_scanning();

	/* backchannel_sync_wait(); */

	/* Wait for the first scan */
	printk("################################################ sync %d ok\n", 0);
	while (new_addr == NULL) {
		k_msleep(10);
	}

	for (uint16_t i = 0; i < 5; i++) {
		int64_t diff, time_diff_ms, rpa_timeout_ms;

		backchannel_sync_wait();
		/* printk("################################################ sync %d ok\n", i+1); */

		/* Compare old and new address */
		err = bt_addr_le_cmp(&old_addr, new_addr);
		if (err == 0) {
			FAIL("RPA did not rotate", err);
		}

		/* Ensure the RPA rotation occurs within +-10% of CONFIG_BT_RPA_TIMEOUT */
		time_diff_ms = new_time - old_time;
		rpa_timeout_ms = CONFIG_BT_RPA_TIMEOUT * MSEC_PER_SEC;

		if (time_diff_ms > rpa_timeout_ms) {
			diff = time_diff_ms - rpa_timeout_ms;
		} else {
			diff = rpa_timeout_ms - time_diff_ms;
		}

		if (diff > (rpa_timeout_ms / 10)) {
			FAIL("RPA rotation did not occur within +-10%% of CONFIG_BT_RPA_TIMEOUT\n");
		}

		printk("Old ");
		print_address(&old_addr);
		printk("New ");
		print_address(new_addr);

		old_addr = *new_addr;
		old_time = new_time;
	}

	PASS("PASS\n");
}
```

## src/tester_rpa_rotation.c
```c
/*
 * Copyright (c) 2023 Nordic Semiconductor ASA
 *
 * SPDX-License-Identifier: Apache-2.0
 */

#include "bs_bt_utils.h"
#include <zephyr/bluetooth/addr.h>
#include <zephyr/bluetooth/conn.h>
#include <stdint.h>
#include <zephyr/bluetooth/bluetooth.h>
#include <zephyr/settings/settings.h>

#define EXPECTED_NUM_ROTATIONS 5

struct adv_set_data_t {
	bt_addr_le_t	old_addr;
	int64_t		old_time;
	int		rpa_rotations;
	bool            addr_set;
};

static	uint8_t	adv_index;
static	struct	adv_set_data_t	adv_set_data[CONFIG_BT_EXT_ADV_MAX_ADV_SET];

static bool data_cb(struct bt_data *data, void *user_data)
{
	switch (data->type) {
	case BT_DATA_MANUFACTURER_DATA:
		adv_index = data->data[0];
		return false;
	default:
		return true;
	}
}

static void validate_rpa_addr_generated_for_adv_sets(void)
{
	for (int i = 0; i < CONFIG_BT_EXT_ADV_MAX_ADV_SET; i++) {
		if (!adv_set_data[i].addr_set) {
			return;
		}
	}
	if (bt_addr_le_eq(&adv_set_data[0].old_addr, &adv_set_data[1].old_addr)) {
		/* With RPA sharing mode disabled, the first two adv sets should have
		 * a different address even though they use the same Bluetooth ID.
		 */
		if (!IS_ENABLED(CONFIG_BT_RPA_SHARING)) {
			FAIL("RPA same for adv sets with same id and RPA sharing disabled\n");
		}
	} else {
		/* In the RPA sharing mode, the first two adv sets should have
		 * the same address as they use the same Bluetooth ID.
		 */
		if (IS_ENABLED(CONFIG_BT_RPA_SHARING)) {
			FAIL("RPA not same for adv sets with same id and RPA sharing enabled\n");
		}
	}
	if (bt_addr_le_eq(&adv_set_data[0].old_addr, &adv_set_data[2].old_addr)) {
		FAIL("RPA same for adv sets with different id's\n");
	}
	if (bt_addr_le_eq(&adv_set_data[1].old_addr, &adv_set_data[3].old_addr)) {
		FAIL("RPA same for adv sets with different id's\n");
	}

	for (int i = 0; i < CONFIG_BT_EXT_ADV_MAX_ADV_SET; i++) {
		adv_set_data[i].addr_set	= false;
	}
}

static void test_address(bt_addr_le_t *addr)
{
	int64_t diff_ms, rpa_timeout_ms;

	if (!BT_ADDR_IS_RPA(&addr->a)) {
		FAIL("Bluetooth address is not RPA\n");
	}

	/* Only save the address + time if this is the first scan */
	if (bt_addr_le_eq(&adv_set_data[adv_index].old_addr, BT_ADDR_LE_ANY)) {
		bt_addr_le_copy(&adv_set_data[adv_index].old_addr, addr);
		adv_set_data[adv_index].old_time = k_uptime_get();
		return;
	}

	/* Compare old and new address */
	if (bt_addr_le_eq(&adv_set_data[adv_index].old_addr, addr)) {
		return;
	}
	adv_set_data[adv_index].addr_set = true;
	printk("Ad set %d Old ", adv_index);
	print_address(&adv_set_data[adv_index].old_addr);
	printk("Ad set %d New ", adv_index);
	print_address(addr);

	adv_set_data[adv_index].rpa_rotations++;

	/* Ensure the RPA rotation occurs within +-10% of CONFIG_BT_RPA_TIMEOUT */
	diff_ms = k_uptime_get() - adv_set_data[adv_index].old_time;
	rpa_timeout_ms = CONFIG_BT_RPA_TIMEOUT * MSEC_PER_SEC;

	if (abs(diff_ms - rpa_timeout_ms) > (rpa_timeout_ms / 10)) {
		FAIL("RPA rotation did not occur within +-10%% of CONFIG_BT_RPA_TIMEOUT\n");
	}

	bt_addr_le_copy(&adv_set_data[adv_index].old_addr, addr);
	adv_set_data[adv_index].old_time = k_uptime_get();
	validate_rpa_addr_generated_for_adv_sets();

	if (adv_set_data[adv_index].rpa_rotations > EXPECTED_NUM_ROTATIONS) {
		PASS("PASS\n");
	}
}

static void cb_device_found(const bt_addr_le_t *addr, int8_t rssi, uint8_t type,
			    struct net_buf_simple *ad)
{
	bt_data_parse(ad, data_cb, NULL);
	test_address((bt_addr_le_t *)addr);
}

void start_scanning(void)
{
	/* Start passive scanning */
	struct bt_le_scan_param scan_param = {
		.type       = BT_HCI_LE_SCAN_PASSIVE,
		.options    = BT_LE_SCAN_OPT_FILTER_DUPLICATE,
		.interval   = 0x0040,
		.window     = 0x0020,
	};

	int err = bt_le_scan_start(&scan_param, cb_device_found);

	if (err) {
		FAIL("Failed to start scanning");
	}
}

void tester_procedure(void)
{
	/* Enable bluetooth */
	int err = bt_enable(NULL);

	if (err) {
		FAIL("Failed to enable bluetooth (err %d\n)", err);
	}

	err = settings_load();
	if (err) {
		FAIL("Failed to enable settings (err %d\n)", err);
	}

	start_scanning();
	/* The rest of the test is driven by the callback */
}
```
